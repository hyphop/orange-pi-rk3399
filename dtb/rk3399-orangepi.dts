/dts-v1/;

/ {
	compatible = "rockchip,rk3399-excavator-linux", "rockchip,rk3399";
	interrupt-parent = <0x1>;
	#address-cells = <0x2>;
	#size-cells = <0x2>;
	model = "Rockchip RK3399 Excavator Board (Linux Opensource)";

// hyphop

	chosen {
		bootargs = "earlycon=uart8250,mmio32,0xff1a0000 swiotlb=1";
		stdout-path = "serial2:1500000n8";
	};

//
	
	ddr_timing {
		compatible = "rockchip,ddr-timing";
		ddr3_speed_bin = <0x15>;
		pd_idle = <0x0>;
		sr_idle = <0x0>;
		sr_mc_gate_idle = <0x0>;
		srpd_lite_idle = <0x0>;
		standby_idle = <0x0>;
		auto_lp_dis_freq = <0x29a>;
		ddr3_dll_dis_freq = <0x12c>;
		phy_dll_dis_freq = <0x104>;
		ddr3_odt_dis_freq = <0x29a>;
		ddr3_drv = <0x28>;
		ddr3_odt = <0x78>;
		phy_ddr3_ca_drv = <0x28>;
		phy_ddr3_dq_drv = <0x28>;
		phy_ddr3_odt = <0xf0>;
		lpddr3_odt_dis_freq = <0x29a>;
		lpddr3_drv = <0x22>;
		lpddr3_odt = <0xf0>;
		phy_lpddr3_ca_drv = <0x22>;
		phy_lpddr3_dq_drv = <0x22>;
		phy_lpddr3_odt = <0xf0>;
		lpddr4_odt_dis_freq = <0x3a5>;
		lpddr4_drv = <0x3c>;
		lpddr4_dq_odt = <0x28>;
		lpddr4_ca_odt = <0x28>;
		phy_lpddr4_ca_drv = <0x28>;
		phy_lpddr4_ck_cs_drv = <0x50>;
		phy_lpddr4_dq_drv = <0x50>;
		phy_lpddr4_odt = <0x3c>;
		linux,phandle = <0x96>;
		phandle = <0x96>;
	};

	aliases {
		i2c0 = "/i2c@ff3c0000";
		i2c1 = "/i2c@ff110000";
		i2c2 = "/i2c@ff120000";
		i2c3 = "/i2c@ff130000";
		i2c4 = "/i2c@ff3d0000";
		i2c5 = "/i2c@ff140000";
		i2c6 = "/i2c@ff150000";
		i2c7 = "/i2c@ff160000";
		i2c8 = "/i2c@ff3e0000";
		serial0 = "/serial@ff180000";
		serial1 = "/serial@ff190000";
		serial2 = "/serial@ff1a0000";
		serial3 = "/serial@ff1b0000";
		serial4 = "/serial@ff370000";
		dsi0 = "/dsi@ff960000";
		dsi1 = "/dsi@ff968000";
	};

	cpus {
		#address-cells = <0x2>;
		#size-cells = <0x0>;

		cpu-map {

			cluster0 {

				core0 {
					cpu = <0x2>;
				};

				core1 {
					cpu = <0x3>;
				};

				core2 {
					cpu = <0x4>;
				};

				core3 {
					cpu = <0x5>;
				};
			};

			cluster1 {

				core0 {
					cpu = <0x6>;
				};

				core1 {
					cpu = <0x7>;
				};
			};
		};

		cpu@0 {
			device_type = "cpu";
			compatible = "arm,cortex-a53", "arm,armv8";
			reg = <0x0 0x0>;
			enable-method = "psci";
			#cooling-cells = <0x2>;
			dynamic-power-coefficient = <0x64>;
			clocks = <0x8 0x8>;
			cpu-idle-states = <0x9 0xa>;
			operating-points-v2 = <0xb>;
			sched-energy-costs = <0xc 0xd>;
			cpu-supply = <0xe>;
			linux,phandle = <0x2>;
			phandle = <0x2>;
		};

		cpu@1 {
			device_type = "cpu";
			compatible = "arm,cortex-a53", "arm,armv8";
			reg = <0x0 0x1>;
			enable-method = "psci";
			clocks = <0x8 0x8>;
			cpu-idle-states = <0x9 0xa>;
			operating-points-v2 = <0xb>;
			sched-energy-costs = <0xc 0xd>;
			cpu-supply = <0xe>;
			linux,phandle = <0x3>;
			phandle = <0x3>;
		};

		cpu@2 {
			device_type = "cpu";
			compatible = "arm,cortex-a53", "arm,armv8";
			reg = <0x0 0x2>;
			enable-method = "psci";
			clocks = <0x8 0x8>;
			cpu-idle-states = <0x9 0xa>;
			operating-points-v2 = <0xb>;
			sched-energy-costs = <0xc 0xd>;
			cpu-supply = <0xe>;
			linux,phandle = <0x4>;
			phandle = <0x4>;
		};

		cpu@3 {
			device_type = "cpu";
			compatible = "arm,cortex-a53", "arm,armv8";
			reg = <0x0 0x3>;
			enable-method = "psci";
			clocks = <0x8 0x8>;
			cpu-idle-states = <0x9 0xa>;
			operating-points-v2 = <0xb>;
			sched-energy-costs = <0xc 0xd>;
			cpu-supply = <0xe>;
			linux,phandle = <0x5>;
			phandle = <0x5>;
		};

		cpu@100 {
			device_type = "cpu";
			compatible = "arm,cortex-a72", "arm,armv8";
			reg = <0x0 0x100>;
			enable-method = "psci";
			#cooling-cells = <0x2>;
			dynamic-power-coefficient = <0x1b4>;
			clocks = <0x8 0x9>;
			cpu-idle-states = <0x9 0xa>;
			operating-points-v2 = <0xf>;
			sched-energy-costs = <0x10 0x11>;
			cpu-supply = <0x12>;
			linux,phandle = <0x6>;
			phandle = <0x6>;
		};

		cpu@101 {
			device_type = "cpu";
			compatible = "arm,cortex-a72", "arm,armv8";
			reg = <0x0 0x101>;
			enable-method = "psci";
			clocks = <0x8 0x9>;
			cpu-idle-states = <0x9 0xa>;
			operating-points-v2 = <0xf>;
			sched-energy-costs = <0x10 0x11>;
			cpu-supply = <0x12>;
			linux,phandle = <0x7>;
			phandle = <0x7>;
		};

		idle-states {
			entry-method = "psci";

			cpu-sleep {
				compatible = "arm,idle-state";
				local-timer-stop;
				arm,psci-suspend-param = <0x10000>;
				entry-latency-us = <0x78>;
				exit-latency-us = <0xfa>;
				min-residency-us = <0x384>;
				linux,phandle = <0x9>;
				phandle = <0x9>;
			};

			cluster-sleep {
				compatible = "arm,idle-state";
				local-timer-stop;
				arm,psci-suspend-param = <0x1010000>;
				entry-latency-us = <0x190>;
				exit-latency-us = <0x1f4>;
				min-residency-us = <0x7d0>;
				linux,phandle = <0xa>;
				phandle = <0xa>;
			};
		};
	};

	pmu_a53 {
		compatible = "arm,cortex-a53-pmu";
		interrupts = <0x1 0x7 0x8 0x13>;
	};

	pmu_a72 {
		compatible = "arm,cortex-a72-pmu";
		interrupts = <0x1 0x7 0x8 0x14>;
	};

	psci {
		compatible = "arm,psci-1.0";
		method = "smc";
	};

	timer {
		compatible = "arm,armv8-timer";
		interrupts = <0x1 0xd 0x8 0x0 0x1 0xe 0x8 0x0 0x1 0xb 0x8 0x0 0x1 0xa 0x8 0x0>;
	};

	xin24m {
		compatible = "fixed-clock";
		clock-frequency = <0x16e3600>;
		clock-output-names = "xin24m";
		#clock-cells = <0x0>;
	};

	dummy_cpll {
		compatible = "fixed-clock";
		clock-frequency = <0x0>;
		clock-output-names = "dummy_cpll";
		#clock-cells = <0x0>;
	};

	dummy_vpll {
		compatible = "fixed-clock";
		clock-frequency = <0x0>;
		clock-output-names = "dummy_vpll";
		#clock-cells = <0x0>;
	};

	amba {
		compatible = "arm,amba-bus";
		#address-cells = <0x2>;
		#size-cells = <0x2>;
		ranges;

		dma-controller@ff6d0000 {
			compatible = "arm,pl330", "arm,primecell";
			reg = <0x0 0xff6d0000 0x0 0x4000>;
			interrupts = <0x0 0x5 0x4 0x0 0x0 0x6 0x4 0x0>;
			#dma-cells = <0x1>;
			clocks = <0x8 0xd3>;
			clock-names = "apb_pclk";
			peripherals-req-type-burst;
			linux,phandle = <0x9e>;
			phandle = <0x9e>;
		};

		dma-controller@ff6e0000 {
			compatible = "arm,pl330", "arm,primecell";
			reg = <0x0 0xff6e0000 0x0 0x4000>;
			interrupts = <0x0 0x7 0x4 0x0 0x0 0x8 0x4 0x0>;
			#dma-cells = <0x1>;
			clocks = <0x8 0xd4>;
			clock-names = "apb_pclk";
			peripherals-req-type-burst;
		};
	};

	ethernet@fe300000 {
		compatible = "rockchip,rk3399-gmac";
		reg = <0x0 0xfe300000 0x0 0x10000>;
		rockchip,grf = <0x15>;
		interrupts = <0x0 0xc 0x4 0x0>;
		interrupt-names = "macirq";
		clocks = <0x8 0x69 0x8 0x67 0x8 0x68 0x8 0x66 0x8 0x6a 0x8 0xd5 0x8 0x166>;
		clock-names = "stmmaceth", "mac_clk_rx", "mac_clk_tx", "clk_mac_ref", "clk_mac_refout", "aclk_mac", "pclk_mac";
		resets = <0x8 0x89>;
		reset-names = "stmmaceth";
		power-domains = <0x16 0x16>;
		status = "okay";
		phy-supply = <0x17>;
		phy-mode = "rgmii";
		clock_in_out = "input";
		snps,reset-gpio = <0x18 0xf 0x1>;
		snps,reset-active-low;
		snps,reset-delays-us = <0x0 0x2710 0xc350>;
		assigned-clocks = <0x8 0xa6>;
		assigned-clock-parents = <0x19>;
		pinctrl-names = "default";
		pinctrl-0 = <0x1a>;
		tx_delay = <0x28>;
		rx_delay = <0x11>;
	};

	dwmmc@fe310000 {
		compatible = "rockchip,rk3399-dw-mshc", "rockchip,rk3288-dw-mshc";
		reg = <0x0 0xfe310000 0x0 0x4000>;
		interrupts = <0x0 0x40 0x4 0x0>;
		clock-freq-min-max = <0x30d40 0x2faf080>;
		clocks = <0x8 0x1ee 0x8 0x4d 0x8 0x9c 0x8 0x9d>;
		clock-names = "biu", "ciu", "ciu-drive", "ciu-sample";
		fifo-depth = <0x100>;
		power-domains = <0x16 0x1c>;
		status = "okay";
		clock-frequency = <0x2faf080>;
		supports-sdio;
		bus-width = <0x4>;
		disable-wp;
		cap-sd-highspeed;
		cap-sdio-irq;
		keep-power-in-suspend;
		mmc-pwrseq = <0x1b>;
		non-removable;
		num-slots = <0x1>;
		pinctrl-names = "default";
		pinctrl-0 = <0x1c 0x1d 0x1e>;
		sd-uhs-sdr104;
	};

	dwmmc@fe320000 {
		compatible = "rockchip,rk3399-dw-mshc", "rockchip,rk3288-dw-mshc";
		reg = <0x0 0xfe320000 0x0 0x4000>;
		interrupts = <0x0 0x41 0x4 0x0>;
		clock-freq-min-max = <0x186a0 0x8f0d180>;
		clocks = <0x8 0x1ce 0x8 0x4c 0x8 0x9a 0x8 0x9b>;
		clock-names = "biu", "ciu", "ciu-drive", "ciu-sample";
		fifo-depth = <0x100>;
		power-domains = <0x16 0x1b>;
		status = "okay";
		clock-frequency = <0x8f0d180>;
		supports-sd;
		bus-width = <0x4>;
		cap-mmc-highspeed;
		cap-sd-highspeed;
		disable-wp;
		num-slots = <0x1>;
		vmmc-supply = <0x1f>;
		vqmmc-supply = <0x20>;
		pinctrl-names = "default";
		pinctrl-0 = <0x21 0x22 0x23 0x24>;
	};

	sdhci@fe330000 {
		compatible = "rockchip,rk3399-sdhci-5.1", "arasan,sdhci-5.1";
		reg = <0x0 0xfe330000 0x0 0x10000>;
		interrupts = <0x0 0xb 0x4 0x0>;
		arasan,soc-ctl-syscon = <0x15>;
		assigned-clocks = <0x8 0x4e>;
		assigned-clock-rates = <0xbebc200>;
		clocks = <0x8 0x4e 0x8 0xf0>;
		clock-names = "clk_xin", "clk_ahb";
		clock-output-names = "emmc_cardclock";
		#clock-cells = <0x0>;
		phys = <0x25>;
		phy-names = "phy_arasan";
		power-domains = <0x16 0x17>;
		status = "okay";
		bus-width = <0x8>;
		mmc-hs400-1_8v;
		supports-emmc;
		non-removable;
		keep-power-in-suspend;
		mmc-hs400-enhanced-strobe;
		assigned-clock-parents = <0x8 0x5>;
		linux,phandle = <0x9c>;
		phandle = <0x9c>;
	};

	usb@fe380000 {
		compatible = "generic-ehci";
		reg = <0x0 0xfe380000 0x0 0x20000>;
		interrupts = <0x0 0x1a 0x4 0x0>;
		clocks = <0x8 0x1c8 0x8 0x1c9 0x8 0xa8>;
		clock-names = "hclk_host0", "hclk_host0_arb", "usbphy0_480m";
		phys = <0x26>;
		phy-names = "usb";
		power-domains = <0x16 0xe>;
		status = "okay";
	};

	usb@fe3a0000 {
		compatible = "generic-ohci";
		reg = <0x0 0xfe3a0000 0x0 0x20000>;
		interrupts = <0x0 0x1c 0x4 0x0>;
		clocks = <0x8 0x1c8 0x8 0x1c9 0x8 0xa8>;
		clock-names = "hclk_host0", "hclk_host0_arb", "usbphy0_480m";
		phys = <0x26>;
		phy-names = "usb";
		power-domains = <0x16 0xe>;
		status = "okay";
	};

	usb@fe3c0000 {
		compatible = "generic-ehci";
		reg = <0x0 0xfe3c0000 0x0 0x20000>;
		interrupts = <0x0 0x1e 0x4 0x0>;
		clocks = <0x8 0x1ca 0x8 0x1cb 0x8 0xa9>;
		clock-names = "hclk_host1", "hclk_host1_arb", "usbphy1_480m";
		phys = <0x27>;
		phy-names = "usb";
		power-domains = <0x16 0xe>;
		status = "okay";
	};

	usb@fe3e0000 {
		compatible = "generic-ohci";
		reg = <0x0 0xfe3e0000 0x0 0x20000>;
		interrupts = <0x0 0x20 0x4 0x0>;
		clocks = <0x8 0x1ca 0x8 0x1cb 0x8 0xa9>;
		clock-names = "hclk_host1", "hclk_host1_arb", "usbphy1_480m";
		phys = <0x27>;
		phy-names = "usb";
		power-domains = <0x16 0xe>;
		status = "okay";
	};

	usb@fe800000 {
		compatible = "rockchip,rk3399-dwc3";
		clocks = <0x8 0x81 0x8 0x83 0x8 0xf6 0x8 0xf9>;
		clock-names = "ref_clk", "suspend_clk", "bus_clk", "grf_clk";
		power-domains = <0x16 0x18>;
		resets = <0x8 0x125>;
		reset-names = "usb3-otg";
		#address-cells = <0x2>;
		#size-cells = <0x2>;
		ranges;
		status = "okay";
		extcon = <0x28>;

		dwc3@fe800000 {
			compatible = "snps,dwc3";
			reg = <0x0 0xfe800000 0x0 0x100000>;
			interrupts = <0x0 0x69 0x4 0x0>;
			dr_mode = "otg";
			phys = <0x29 0x2a>;
			phy-names = "usb2-phy", "usb3-phy";
			phy_type = "utmi_wide";
			snps,dis_enblslpm_quirk;
			snps,dis-u2-freeclk-exists-quirk;
			snps,dis_u2_susphy_quirk;
			snps,dis-del-phy-power-chg-quirk;
			snps,tx-ipgap-linecheck-dis-quirk;
			snps,xhci-slow-suspend-quirk;
			snps,usb3-warm-reset-on-resume-quirk;
			status = "okay";
		};
	};

	usb@fe900000 {
		compatible = "rockchip,rk3399-dwc3";
		clocks = <0x8 0x82 0x8 0x84 0x8 0xf7 0x8 0xf9>;
		clock-names = "ref_clk", "suspend_clk", "bus_clk", "grf_clk";
		power-domains = <0x16 0x18>;
		resets = <0x8 0x126>;
		reset-names = "usb3-otg";
		#address-cells = <0x2>;
		#size-cells = <0x2>;
		ranges;
		status = "okay";

		dwc3@fe900000 {
			compatible = "snps,dwc3";
			reg = <0x0 0xfe900000 0x0 0x100000>;
			interrupts = <0x0 0x6e 0x4 0x0>;
			dr_mode = "host";
			phys = <0x2b 0x2c>;
			phy-names = "usb2-phy", "usb3-phy";
			phy_type = "utmi_wide";
			snps,dis_enblslpm_quirk;
			snps,dis-u2-freeclk-exists-quirk;
			snps,dis_u2_susphy_quirk;
			snps,dis-del-phy-power-chg-quirk;
			snps,tx-ipgap-linecheck-dis-quirk;
			snps,xhci-slow-suspend-quirk;
			snps,usb3-warm-reset-on-resume-quirk;
			status = "okay";
		};
	};

	dp@fec00000 {
		compatible = "rockchip,rk3399-cdn-dp";
		reg = <0x0 0xfec00000 0x0 0x100000>;
		interrupts = <0x0 0x9 0x4>;
		clocks = <0x8 0x72 0x8 0x175 0x8 0xa1 0x8 0x16f>;
		clock-names = "core-clk", "pclk", "spdif", "grf";
		assigned-clocks = <0x8 0x72>;
		assigned-clock-rates = <0x5f5e100>;
		power-domains = <0x16 0x15>;
		phys = <0x2d 0x2e>;
		resets = <0x8 0x103 0x8 0x148 0x8 0x14a 0x8 0xfd>;
		reset-names = "spdif", "dptx", "apb", "core";
		rockchip,grf = <0x15>;
		#address-cells = <0x1>;
		#size-cells = <0x0>;
		#sound-dai-cells = <0x1>;
		status = "disabled";

		ports {
			#address-cells = <0x1>;
			#size-cells = <0x0>;

			port {
				#address-cells = <0x1>;
				#size-cells = <0x0>;

				endpoint@0 {
					reg = <0x0>;
					remote-endpoint = <0x2f>;
					linux,phandle = <0xaf>;
					phandle = <0xaf>;
				};

				endpoint@1 {
					reg = <0x1>;
					remote-endpoint = <0x30>;
					linux,phandle = <0xa8>;
					phandle = <0xa8>;
				};
			};
		};
	};

	interrupt-controller@fee00000 {
		compatible = "arm,gic-v3";
		#interrupt-cells = <0x4>;
		#address-cells = <0x2>;
		#size-cells = <0x2>;
		ranges;
		interrupt-controller;
		reg = <0x0 0xfee00000 0x0 0x10000 0x0 0xfef00000 0x0 0xc0000 0x0 0xfff00000 0x0 0x10000 0x0 0xfff10000 0x0 0x10000 0x0 0xfff20000 0x0 0x10000>;
		interrupts = <0x1 0x9 0x4 0x0>;
		linux,phandle = <0x1>;
		phandle = <0x1>;

		interrupt-controller@fee20000 {
			compatible = "arm,gic-v3-its";
			msi-controller;
			reg = <0x0 0xfee20000 0x0 0x20000>;
			linux,phandle = <0x8c>;
			phandle = <0x8c>;
		};

		ppi-partitions {

			interrupt-partition-0 {
				affinity = <0x2 0x3 0x4 0x5>;
				linux,phandle = <0x13>;
				phandle = <0x13>;
			};

			interrupt-partition-1 {
				affinity = <0x6 0x7>;
				linux,phandle = <0x14>;
				phandle = <0x14>;
			};
		};
	};

	saradc@ff100000 {
		compatible = "rockchip,rk3399-saradc";
		reg = <0x0 0xff100000 0x0 0x100>;
		interrupts = <0x0 0x3e 0x4 0x0>;
		#io-channel-cells = <0x1>;
		clocks = <0x8 0x50 0x8 0x165>;
		clock-names = "saradc", "apb_pclk";
		resets = <0x8 0xd4>;
		reset-names = "saradc-apb";
		status = "okay";
		vref-supply = <0x31>;
		linux,phandle = <0xe2>;
		phandle = <0xe2>;
	};

	i2c@ff3c0000 {
		compatible = "rockchip,rk3399-i2c";
		reg = <0x0 0xff3c0000 0x0 0x1000>;
		clocks = <0x32 0x9 0x32 0x1b>;
		clock-names = "i2c", "pclk";
		interrupts = <0x0 0x39 0x4 0x0>;
		pinctrl-names = "default";
		pinctrl-0 = <0x33>;
		#address-cells = <0x1>;
		#size-cells = <0x0>;
		status = "okay";
		i2c-scl-rising-time-ns = <0xa8>;
		i2c-scl-falling-time-ns = <0x4>;
		clock-frequency = <0x61a80>;

		syr827@40 {
			compatible = "silergy,syr827";
			reg = <0x40>;
			vin-supply = <0x34>;
			regulator-compatible = "fan53555-reg";
			pinctrl-names = "default";
			pinctrl-0 = <0x35>;
			vsel-gpios = <0x36 0x11 0x0>;
			regulator-name = "vdd_cpu_b";
			regulator-min-microvolt = <0xadf34>;
			regulator-max-microvolt = <0x16e360>;
			regulator-ramp-delay = <0x3e8>;
			fcs,suspend-voltage-selector = <0x1>;
			regulator-always-on;
			regulator-boot-on;
			regulator-initial-state = <0x3>;
			linux,phandle = <0x12>;
			phandle = <0x12>;

			regulator-state-mem {
				regulator-off-in-suspend;
			};
		};

		syr828@41 {
			compatible = "silergy,syr828";
			reg = <0x41>;
			vin-supply = <0x34>;
			regulator-compatible = "fan53555-reg";
			pinctrl-names = "default";
			pinctrl-0 = <0x37>;
			vsel-gpios = <0x36 0xe 0x0>;
			regulator-name = "vdd_gpu";
			regulator-min-microvolt = <0xadf34>;
			regulator-max-microvolt = <0x16e360>;
			regulator-ramp-delay = <0x3e8>;
			fcs,suspend-voltage-selector = <0x1>;
			regulator-always-on;
			regulator-boot-on;
			regulator-initial-state = <0x3>;
			linux,phandle = <0xa3>;
			phandle = <0xa3>;

			regulator-state-mem {
				regulator-off-in-suspend;
			};
		};

		pmic@1b {
			compatible = "rockchip,rk808";
			reg = <0x1b>;
			interrupt-parent = <0x36>;
			interrupts = <0x15 0x8>;
			pinctrl-names = "default";
			pinctrl-0 = <0x38 0x39>;
			rockchip,system-power-controller;
			wakeup-source;
			#clock-cells = <0x1>;
			clock-output-names = "xin32k", "rk808-clkout2";
			vcc1-supply = <0x3a>;
			vcc2-supply = <0x3a>;
			vcc3-supply = <0x3a>;
			vcc4-supply = <0x3a>;
			vcc6-supply = <0x3a>;
			vcc7-supply = <0x3a>;
			vcc8-supply = <0x3a>;
			vcc9-supply = <0x3a>;
			vcc10-supply = <0x3a>;
			vcc11-supply = <0x3a>;
			vcc12-supply = <0x3a>;
			vddio-supply = <0x3b>;
			linux,phandle = <0xcd>;
			phandle = <0xcd>;

			regulators {

				DCDC_REG1 {
					regulator-always-on;
					regulator-boot-on;
					regulator-min-microvolt = <0xb71b0>;
					regulator-max-microvolt = <0x149970>;
					regulator-ramp-delay = <0x1771>;
					regulator-name = "vdd_center";

					regulator-state-mem {
						regulator-off-in-suspend;
					};
				};

				DCDC_REG2 {
					regulator-always-on;
					regulator-boot-on;
					regulator-min-microvolt = <0xb71b0>;
					regulator-max-microvolt = <0x149970>;
					regulator-ramp-delay = <0x1771>;
					regulator-name = "vdd_cpu_l";
					linux,phandle = <0xe>;
					phandle = <0xe>;

					regulator-state-mem {
						regulator-off-in-suspend;
					};
				};

				DCDC_REG3 {
					regulator-always-on;
					regulator-boot-on;
					regulator-name = "vcc_ddr";

					regulator-state-mem {
						regulator-on-in-suspend;
					};
				};

				DCDC_REG4 {
					regulator-always-on;
					regulator-boot-on;
					regulator-min-microvolt = <0x1b7740>;
					regulator-max-microvolt = <0x1b7740>;
					regulator-name = "vcc_1v8";

					regulator-state-mem {
						regulator-on-in-suspend;
						regulator-suspend-microvolt = <0x1b7740>;
					};
				};

				LDO_REG1 {
					regulator-always-on;
					regulator-boot-on;
					regulator-min-microvolt = <0x1b7740>;
					regulator-max-microvolt = <0x1b7740>;
					regulator-name = "vcc1v8_dvp";

					regulator-state-mem {
						regulator-off-in-suspend;
					};
				};

				LDO_REG2 {
					regulator-always-on;
					regulator-boot-on;
					regulator-min-microvolt = <0x2dc6c0>;
					regulator-max-microvolt = <0x2dc6c0>;
					regulator-name = "vcc3v0_tp";

					regulator-state-mem {
						regulator-off-in-suspend;
					};
				};

				LDO_REG3 {
					regulator-always-on;
					regulator-boot-on;
					regulator-min-microvolt = <0x1b7740>;
					regulator-max-microvolt = <0x1b7740>;
					regulator-name = "vcc1v8_pmu";
					linux,phandle = <0x3b>;
					phandle = <0x3b>;

					regulator-state-mem {
						regulator-on-in-suspend;
						regulator-suspend-microvolt = <0x1b7740>;
					};
				};

				LDO_REG4 {
					regulator-always-on;
					regulator-boot-on;
					regulator-min-microvolt = <0x1b7740>;
					regulator-max-microvolt = <0x2dc6c0>;
					regulator-name = "vccio_sd";
					linux,phandle = <0x20>;
					phandle = <0x20>;

					regulator-state-mem {
						regulator-on-in-suspend;
						regulator-suspend-microvolt = <0x2dc6c0>;
					};
				};

				LDO_REG5 {
					regulator-always-on;
					regulator-boot-on;
					regulator-min-microvolt = <0x2dc6c0>;
					regulator-max-microvolt = <0x2dc6c0>;
					regulator-name = "vcca3v0_codec";

					regulator-state-mem {
						regulator-off-in-suspend;
					};
				};

				LDO_REG6 {
					regulator-always-on;
					regulator-boot-on;
					regulator-min-microvolt = <0x16e360>;
					regulator-max-microvolt = <0x16e360>;
					regulator-name = "vcc_1v5";

					regulator-state-mem {
						regulator-on-in-suspend;
						regulator-suspend-microvolt = <0x16e360>;
					};
				};

				LDO_REG7 {
					regulator-always-on;
					regulator-boot-on;
					regulator-min-microvolt = <0x1b7740>;
					regulator-max-microvolt = <0x1b7740>;
					regulator-name = "vcca1v8_codec";
					linux,phandle = <0x9b>;
					phandle = <0x9b>;

					regulator-state-mem {
						regulator-off-in-suspend;
					};
				};

				LDO_REG8 {
					regulator-always-on;
					regulator-boot-on;
					regulator-min-microvolt = <0x2dc6c0>;
					regulator-max-microvolt = <0x2dc6c0>;
					regulator-name = "vcc_3v0";
					linux,phandle = <0x82>;
					phandle = <0x82>;

					regulator-state-mem {
						regulator-on-in-suspend;
						regulator-suspend-microvolt = <0x2dc6c0>;
					};
				};

				SWITCH_REG1 {
					regulator-always-on;
					regulator-boot-on;
					regulator-name = "vcc3v3_s3";

					regulator-state-mem {
						regulator-off-in-suspend;
					};
				};

				SWITCH_REG2 {
					regulator-always-on;
					regulator-boot-on;
					regulator-name = "vcc3v3_s0";
					linux,phandle = <0xdc>;
					phandle = <0xdc>;

					regulator-state-mem {
						regulator-off-in-suspend;
					};
				};
			};
		};
	};

	i2c@ff110000 {
		compatible = "rockchip,rk3399-i2c";
		reg = <0x0 0xff110000 0x0 0x1000>;
		clocks = <0x8 0x41 0x8 0x155>;
		clock-names = "i2c", "pclk";
		interrupts = <0x0 0x3b 0x4 0x0>;
		pinctrl-names = "default";
		pinctrl-0 = <0x3c>;
		#address-cells = <0x1>;
		#size-cells = <0x0>;
		status = "okay";
		i2c-scl-rising-time-ns = <0x12c>;
		i2c-scl-falling-time-ns = <0xf>;

		rt5651@1a {
			#sound-dai-cells = <0x0>;
			compatible = "rockchip,rt5651";
			reg = <0x1a>;
			clocks = <0x8 0x59>;
			clock-names = "mclk";
			pinctrl-names = "default";
			pinctrl-0 = <0x3d>;
			spk-con-gpio = <0x3e 0xb 0x0>;
			hp-det-gpio = <0x3f 0x1c 0x1>;
			linux,phandle = <0xd3>;
			phandle = <0xd3>;
		};

		gt9xx@14 {
			compatible = "goodix,gt9xx";
			reg = <0x14>;
			touch-gpio = <0x36 0x14 0x8>;
			reset-gpio = <0x3e 0xc 0x0>;
			max-x = <0x320>;
			max-y = <0x500>;
			tp-size = <0x65>;
			status = "okay";
		};

		camera-module@10 {
			status = "disable";
			compatible = "omnivision,ov13850-v4l2-i2c-subdev";
			reg = <0x10>;
			device_type = "v4l2-i2c-subdev";
			clocks = <0x8 0x89>;
			clock-names = "clk_cif_out";
			pinctrl-names = "rockchip,camera_default", "rockchip,camera_sleep";
			pinctrl-0 = <0x40>;
			pinctrl-1 = <0x41>;
			rockchip,pd-gpio = <0x42 0x4 0x1>;
			rockchip,pwr-gpio = <0x36 0x4 0x0>;
			rockchip,rst-gpio = <0x3e 0x8 0x1>;
			rockchip,camera-module-mclk-name = "clk_cif_out";
			rockchip,camera-module-facing = "front";
			rockchip,camera-module-name = "cmk-cb0695-fv1";
			rockchip,camera-module-len-name = "lg9569a2";
			rockchip,camera-module-fov-h = "66.0";
			rockchip,camera-module-fov-v = "50.1";
			rockchip,camera-module-orientation = <0x0>;
			rockchip,camera-module-iq-flip = <0x0>;
			rockchip,camera-module-iq-mirror = <0x0>;
			rockchip,camera-module-flip = <0x1>;
			rockchip,camera-module-mirror = <0x0>;
			rockchip,camera-module-defrect0 = <0x840 0x620 0x0 0x0 0x840 0x620>;
			rockchip,camera-module-defrect1 = <0x1080 0xc40 0x0 0x0 0x1080 0xc40>;
			rockchip,camera-module-defrect3 = <0xcc0 0x990 0x0 0x0 0xcc0 0x990>;
			rockchip,camera-module-flash-support = <0x0>;
			rockchip,camera-module-mipi-dphy-index = <0x0>;
			linux,phandle = <0xd9>;
			phandle = <0xd9>;
		};

		camera-module@1 {
			status = "disable";
			compatible = "toshiba,tc358749xbg-v4l2-i2c-subdev";
			reg = <0xf>;
			device_type = "v4l2-i2c-subdev";
			clocks = <0x8 0x89>;
			clock-names = "clk_cif_out";
			pinctrl-names = "default";
			pinctrl-0 = <0x43>;
			power-gpios = <0x42 0x6 0x0>;
			power18-gpios = <0x42 0x9 0x0>;
			power33-gpios = <0x42 0x5 0x0>;
			csi-ctl-gpios = <0x42 0xa 0x0>;
			stanby-gpios = <0x42 0x8 0x0>;
			reset-gpios = <0x42 0x7 0x0>;
			int-gpios = <0x42 0xc 0x0>;
			rockchip,camera-module-mclk-name = "clk_cif_out";
			rockchip,camera-module-mipi-dphy-index = <0x0>;
			linux,phandle = <0xdb>;
			phandle = <0xdb>;
		};
	};

	i2c@ff120000 {
		compatible = "rockchip,rk3399-i2c";
		reg = <0x0 0xff120000 0x0 0x1000>;
		clocks = <0x8 0x42 0x8 0x156>;
		clock-names = "i2c", "pclk";
		interrupts = <0x0 0x23 0x4 0x0>;
		pinctrl-names = "default";
		pinctrl-0 = <0x44>;
		#address-cells = <0x1>;
		#size-cells = <0x0>;
		status = "disabled";
	};

	i2c@ff130000 {
		compatible = "rockchip,rk3399-i2c";
		reg = <0x0 0xff130000 0x0 0x1000>;
		clocks = <0x8 0x43 0x8 0x157>;
		clock-names = "i2c", "pclk";
		interrupts = <0x0 0x22 0x4 0x0>;
		pinctrl-names = "default";
		pinctrl-0 = <0x45>;
		#address-cells = <0x1>;
		#size-cells = <0x0>;
		status = "disabled";
	};

	i2c@ff140000 {
		compatible = "rockchip,rk3399-i2c";
		reg = <0x0 0xff140000 0x0 0x1000>;
		clocks = <0x8 0x44 0x8 0x158>;
		clock-names = "i2c", "pclk";
		interrupts = <0x0 0x26 0x4 0x0>;
		pinctrl-names = "default";
		pinctrl-0 = <0x46>;
		#address-cells = <0x1>;
		#size-cells = <0x0>;
		status = "disabled";
	};

	i2c@ff150000 {
		compatible = "rockchip,rk3399-i2c";
		reg = <0x0 0xff150000 0x0 0x1000>;
		clocks = <0x8 0x45 0x8 0x159>;
		clock-names = "i2c", "pclk";
		interrupts = <0x0 0x25 0x4 0x0>;
		pinctrl-names = "default";
		pinctrl-0 = <0x47>;
		#address-cells = <0x1>;
		#size-cells = <0x0>;
		status = "disabled";
	};

	i2c@ff160000 {
		compatible = "rockchip,rk3399-i2c";
		reg = <0x0 0xff160000 0x0 0x1000>;
		clocks = <0x8 0x46 0x8 0x15a>;
		clock-names = "i2c", "pclk";
		interrupts = <0x0 0x24 0x4 0x0>;
		pinctrl-names = "default";
		pinctrl-0 = <0x48>;
		#address-cells = <0x1>;
		#size-cells = <0x0>;
		status = "disabled";
	};

	serial@ff180000 {
		compatible = "rockchip,rk3399-uart", "snps,dw-apb-uart";
		reg = <0x0 0xff180000 0x0 0x100>;
		clocks = <0x8 0x51 0x8 0x160>;
		clock-names = "baudclk", "apb_pclk";
		interrupts = <0x0 0x63 0x4 0x0>;
		reg-shift = <0x2>;
		reg-io-width = <0x4>;
		pinctrl-names = "default";
		pinctrl-0 = <0x49 0x4a>;
		status = "okay";
		assigned-clocks = <0x8 0xac>;
		assigned-clock-parents = <0x8 0x5>;
	};

	serial@ff190000 {
		compatible = "rockchip,rk3399-uart", "snps,dw-apb-uart";
		reg = <0x0 0xff190000 0x0 0x100>;
		clocks = <0x8 0x52 0x8 0x161>;
		clock-names = "baudclk", "apb_pclk";
		interrupts = <0x0 0x62 0x4 0x0>;
		reg-shift = <0x2>;
		reg-io-width = <0x4>;
		pinctrl-names = "default";
		pinctrl-0 = <0x4b>;
		status = "disabled";
		assigned-clocks = <0x8 0xad>;
		assigned-clock-parents = <0x8 0x5>;
	};

	serial@ff1a0000 {
		compatible = "rockchip,rk3399-uart", "snps,dw-apb-uart";
		reg = <0x0 0xff1a0000 0x0 0x100>;
		clocks = <0x8 0x53 0x8 0x162>;
		clock-names = "baudclk", "apb_pclk";
		interrupts = <0x0 0x64 0x4 0x0>;
		reg-shift = <0x2>;
		reg-io-width = <0x4>;
		pinctrl-names = "default";
		pinctrl-0 = <0x4c>;
		status = "okay";
		assigned-clocks = <0x8 0xad>;
		assigned-clock-parents = <0x8 0x5>;
	};

	serial@ff1b0000 {
		compatible = "rockchip,rk3399-uart", "snps,dw-apb-uart";
		reg = <0x0 0xff1b0000 0x0 0x100>;
		clocks = <0x8 0x54 0x8 0x163>;
		clock-names = "baudclk", "apb_pclk";
		interrupts = <0x0 0x65 0x4 0x0>;
		reg-shift = <0x2>;
		reg-io-width = <0x4>;
		pinctrl-names = "default";
		pinctrl-0 = <0x4d 0x4e 0x4f>;
		status = "disabled";
		assigned-clocks = <0x8 0xad>;
		assigned-clock-parents = <0x8 0x5>;
	};

	spi@ff1c0000 {
		compatible = "rockchip,rk3399-spi", "rockchip,rk3066-spi";
		reg = <0x0 0xff1c0000 0x0 0x1000>;
		clocks = <0x8 0x47 0x8 0x15b>;
		clock-names = "spiclk", "apb_pclk";
		interrupts = <0x0 0x44 0x4 0x0>;
		pinctrl-names = "default";
		pinctrl-0 = <0x50 0x51 0x52 0x53>;
		#address-cells = <0x1>;
		#size-cells = <0x0>;
		status = "disabled";
	};

	spi@ff1d0000 {
		compatible = "rockchip,rk3399-spi", "rockchip,rk3066-spi";
		reg = <0x0 0xff1d0000 0x0 0x1000>;
		clocks = <0x8 0x48 0x8 0x15c>;
		clock-names = "spiclk", "apb_pclk";
		interrupts = <0x0 0x35 0x4 0x0>;
		pinctrl-names = "default";
		pinctrl-0 = <0x54 0x55 0x56 0x57>;
		#address-cells = <0x1>;
		#size-cells = <0x0>;
		status = "disabled";
	};

	spi@ff1e0000 {
		compatible = "rockchip,rk3399-spi", "rockchip,rk3066-spi";
		reg = <0x0 0xff1e0000 0x0 0x1000>;
		clocks = <0x8 0x49 0x8 0x15d>;
		clock-names = "spiclk", "apb_pclk";
		interrupts = <0x0 0x34 0x4 0x0>;
		pinctrl-names = "default";
		pinctrl-0 = <0x58 0x59 0x5a 0x5b>;
		#address-cells = <0x1>;
		#size-cells = <0x0>;
		status = "disabled";
	};

	spi@ff1f0000 {
		compatible = "rockchip,rk3399-spi", "rockchip,rk3066-spi";
		reg = <0x0 0xff1f0000 0x0 0x1000>;
		clocks = <0x8 0x4a 0x8 0x15e>;
		clock-names = "spiclk", "apb_pclk";
		interrupts = <0x0 0x43 0x4 0x0>;
		pinctrl-names = "default";
		pinctrl-0 = <0x5c 0x5d 0x5e 0x5f>;
		#address-cells = <0x1>;
		#size-cells = <0x0>;
		status = "disabled";
	};

	spi@ff200000 {
		compatible = "rockchip,rk3399-spi", "rockchip,rk3066-spi";
		reg = <0x0 0xff200000 0x0 0x1000>;
		clocks = <0x8 0x4b 0x8 0x15f>;
		clock-names = "spiclk", "apb_pclk";
		interrupts = <0x0 0x84 0x4 0x0>;
		pinctrl-names = "default";
		pinctrl-0 = <0x60 0x61 0x62 0x63>;
		#address-cells = <0x1>;
		#size-cells = <0x0>;
		status = "disabled";
	};

	thermal-zones {

		soc-thermal {
			polling-delay-passive = <0x14>;
			polling-delay = <0x3e8>;
			sustainable-power = <0x3e8>;
			thermal-sensors = <0x64 0x0>;

			trips {

				trip-point@0 {
					temperature = <0x11170>;
					hysteresis = <0x7d0>;
					type = "passive";
				};

				trip-point@1 {
					temperature = <0x14c08>;
					hysteresis = <0x7d0>;
					type = "passive";
					linux,phandle = <0x65>;
					phandle = <0x65>;
				};

				soc-crit {
					temperature = <0x17318>;
					hysteresis = <0x7d0>;
					type = "critical";
				};
			};

			cooling-maps {

				map0 {
					trip = <0x65>;
					cooling-device = <0x2 0xffffffff 0xffffffff>;
					contribution = <0x1000>;
				};

				map1 {
					trip = <0x65>;
					cooling-device = <0x6 0xffffffff 0xffffffff>;
					contribution = <0x400>;
				};

				map2 {
					trip = <0x65>;
					cooling-device = <0x66 0xffffffff 0xffffffff>;
					contribution = <0x1000>;
				};
			};
		};

		gpu-thermal {
			polling-delay-passive = <0x64>;
			polling-delay = <0x3e8>;
			thermal-sensors = <0x64 0x1>;
		};
	};

	tsadc@ff260000 {
		compatible = "rockchip,rk3399-tsadc";
		reg = <0x0 0xff260000 0x0 0x100>;
		interrupts = <0x0 0x61 0x4 0x0>;
		rockchip,grf = <0x15>;
		clocks = <0x8 0x4f 0x8 0x164>;
		clock-names = "tsadc", "apb_pclk";
		assigned-clocks = <0x8 0x4f>;
		assigned-clock-rates = <0xb71b0>;
		resets = <0x8 0xe8>;
		reset-names = "tsadc-apb";
		pinctrl-names = "init", "default", "sleep";
		pinctrl-0 = <0x67>;
		pinctrl-1 = <0x68>;
		pinctrl-2 = <0x67>;
		#thermal-sensor-cells = <0x1>;
		rockchip,hw-tshut-temp = <0x17318>;
		status = "okay";
		rockchip,hw-tshut-mode = <0x1>;
		rockchip,hw-tshut-polarity = <0x1>;
		linux,phandle = <0x64>;
		phandle = <0x64>;
	};

	qos@ffa58000 {
		compatible = "syscon";
		reg = <0x0 0xffa58000 0x0 0x20>;
		linux,phandle = <0x70>;
		phandle = <0x70>;
	};

	qos@ffa5c000 {
		compatible = "syscon";
		reg = <0x0 0xffa5c000 0x0 0x20>;
		linux,phandle = <0x71>;
		phandle = <0x71>;
	};

	qos@ffa60080 {
		compatible = "syscon";
		reg = <0x0 0xffa60080 0x0 0x20>;
		linux,phandle = <0x73>;
		phandle = <0x73>;
	};

	qos@ffa60100 {
		compatible = "syscon";
		reg = <0x0 0xffa60100 0x0 0x20>;
		linux,phandle = <0x74>;
		phandle = <0x74>;
	};

	qos@ffa60180 {
		compatible = "syscon";
		reg = <0x0 0xffa60180 0x0 0x20>;
		linux,phandle = <0x75>;
		phandle = <0x75>;
	};

	qos@ffa70000 {
		compatible = "syscon";
		reg = <0x0 0xffa70000 0x0 0x20>;
		linux,phandle = <0x78>;
		phandle = <0x78>;
	};

	qos@ffa70080 {
		compatible = "syscon";
		reg = <0x0 0xffa70080 0x0 0x20>;
		linux,phandle = <0x79>;
		phandle = <0x79>;
	};

	qos@ffa74000 {
		compatible = "syscon";
		reg = <0x0 0xffa74000 0x0 0x20>;
		linux,phandle = <0x76>;
		phandle = <0x76>;
	};

	qos@ffa76000 {
		compatible = "syscon";
		reg = <0x0 0xffa76000 0x0 0x20>;
		linux,phandle = <0x77>;
		phandle = <0x77>;
	};

	qos@ffa90000 {
		compatible = "syscon";
		reg = <0x0 0xffa90000 0x0 0x20>;
		linux,phandle = <0x7a>;
		phandle = <0x7a>;
	};

	qos@ffa98000 {
		compatible = "syscon";
		reg = <0x0 0xffa98000 0x0 0x20>;
		linux,phandle = <0x69>;
		phandle = <0x69>;
	};

	qos@ffaa0000 {
		compatible = "syscon";
		reg = <0x0 0xffaa0000 0x0 0x20>;
		linux,phandle = <0x7b>;
		phandle = <0x7b>;
	};

	qos@ffaa0080 {
		compatible = "syscon";
		reg = <0x0 0xffaa0080 0x0 0x20>;
		linux,phandle = <0x7c>;
		phandle = <0x7c>;
	};

	qos@ffaa8000 {
		compatible = "syscon";
		reg = <0x0 0xffaa8000 0x0 0x20>;
		linux,phandle = <0x7d>;
		phandle = <0x7d>;
	};

	qos@ffaa8080 {
		compatible = "syscon";
		reg = <0x0 0xffaa8080 0x0 0x20>;
		linux,phandle = <0x7e>;
		phandle = <0x7e>;
	};

	qos@ffab0000 {
		compatible = "syscon";
		reg = <0x0 0xffab0000 0x0 0x20>;
		linux,phandle = <0x6a>;
		phandle = <0x6a>;
	};

	qos@ffab0080 {
		compatible = "syscon";
		reg = <0x0 0xffab0080 0x0 0x20>;
		linux,phandle = <0x6b>;
		phandle = <0x6b>;
	};

	qos@ffab8000 {
		compatible = "syscon";
		reg = <0x0 0xffab8000 0x0 0x20>;
		linux,phandle = <0x6c>;
		phandle = <0x6c>;
	};

	qos@ffac0000 {
		compatible = "syscon";
		reg = <0x0 0xffac0000 0x0 0x20>;
		linux,phandle = <0x6d>;
		phandle = <0x6d>;
	};

	qos@ffac0080 {
		compatible = "syscon";
		reg = <0x0 0xffac0080 0x0 0x20>;
		linux,phandle = <0x6e>;
		phandle = <0x6e>;
	};

	qos@ffac8000 {
		compatible = "syscon";
		reg = <0x0 0xffac8000 0x0 0x20>;
		linux,phandle = <0x7f>;
		phandle = <0x7f>;
	};

	qos@ffac8080 {
		compatible = "syscon";
		reg = <0x0 0xffac8080 0x0 0x20>;
		linux,phandle = <0x80>;
		phandle = <0x80>;
	};

	qos@ffad0000 {
		compatible = "syscon";
		reg = <0x0 0xffad0000 0x0 0x20>;
		linux,phandle = <0x81>;
		phandle = <0x81>;
	};

	qos@ffad8080 {
		compatible = "syscon";
		reg = <0x0 0xffad8080 0x0 0x20>;
		linux,phandle = <0x72>;
		phandle = <0x72>;
	};

	qos@ffae0000 {
		compatible = "syscon";
		reg = <0x0 0xffae0000 0x0 0x20>;
		linux,phandle = <0x6f>;
		phandle = <0x6f>;
	};

	power-management@ff310000 {
		compatible = "rockchip,rk3399-pmu", "syscon", "simple-mfd";
		reg = <0x0 0xff310000 0x0 0x1000>;

		power-controller {
			compatible = "rockchip,rk3399-power-controller";
			#power-domain-cells = <0x1>;
			#address-cells = <0x1>;
			#size-cells = <0x0>;
			linux,phandle = <0x16>;
			phandle = <0x16>;

			pd_iep@34 {
				reg = <0x22>;
				clocks = <0x8 0xe1 0x8 0x1dd>;
				pm_qos = <0x69>;
			};

			pd_rga@33 {
				reg = <0x21>;
				clocks = <0x8 0xdc 0x8 0x1e5>;
				pm_qos = <0x6a 0x6b>;
			};

			pd_vcodec@31 {
				reg = <0x1f>;
				clocks = <0x8 0xeb 0x8 0x1ea>;
				pm_qos = <0x6c>;
			};

			pd_vdu@32 {
				reg = <0x20>;
				clocks = <0x8 0xed 0x8 0x1ec>;
				pm_qos = <0x6d 0x6e>;
			};

			pd_gpu@35 {
				reg = <0x23>;
				clocks = <0x8 0xd0>;
				pm_qos = <0x6f>;
			};

			pd_edp@25 {
				reg = <0x19>;
				clocks = <0x8 0x16c>;
			};

			pd_emmc@23 {
				reg = <0x17>;
				clocks = <0x8 0xf0>;
				pm_qos = <0x70>;
			};

			pd_gmac@22 {
				reg = <0x16>;
				clocks = <0x8 0xd5 0x8 0x166>;
				pm_qos = <0x71>;
			};

			pd_perihp@14 {
				reg = <0xe>;
				#address-cells = <0x1>;
				#size-cells = <0x0>;
				clocks = <0x8 0xc0>;
				pm_qos = <0x72 0x73 0x74 0x75>;

				pd_sd@27 {
					reg = <0x1b>;
					clocks = <0x8 0x1ce 0x8 0x4c>;
					pm_qos = <0x76>;
				};
			};

			pd_sdioaudio@28 {
				reg = <0x1c>;
				clocks = <0x8 0x1ee>;
				pm_qos = <0x77>;
			};

			pd_usb3@24 {
				reg = <0x18>;
				clocks = <0x8 0xf4>;
				pm_qos = <0x78 0x79>;
			};

			pd_vio@15 {
				reg = <0xf>;
				#address-cells = <0x1>;
				#size-cells = <0x0>;

				pd_hdcp@21 {
					reg = <0x15>;
					clocks = <0x8 0xde 0x8 0x1e7 0x8 0x172>;
					pm_qos = <0x7a>;
				};

				pd_isp0@19 {
					reg = <0x13>;
					clocks = <0x8 0xe5 0x8 0x1df>;
					pm_qos = <0x7b 0x7c>;
				};

				pd_isp1@20 {
					reg = <0x14>;
					clocks = <0x8 0xe6 0x8 0x1e0>;
					pm_qos = <0x7d 0x7e>;
				};

				pd_tcpc0@RK3399_PD_TCPC0 {
					reg = <0x8>;
					clocks = <0x8 0x7e 0x8 0x7d>;
				};

				pd_tcpc1@RK3399_PD_TCPC1 {
					reg = <0x9>;
					clocks = <0x8 0x80 0x8 0x7f>;
				};

				pd_vo@16 {
					reg = <0x10>;
					#address-cells = <0x1>;
					#size-cells = <0x0>;

					pd_vopb@17 {
						reg = <0x11>;
						clocks = <0x8 0xd9 0x8 0x1d9>;
						pm_qos = <0x7f 0x80>;
					};

					pd_vopl@18 {
						reg = <0x12>;
						clocks = <0x8 0xdb 0x8 0x1db>;
						pm_qos = <0x81>;
					};
				};
			};
		};
	};

	syscon@ff320000 {
		compatible = "rockchip,rk3399-pmugrf", "syscon", "simple-mfd";
		reg = <0x0 0xff320000 0x0 0x1000>;
		#address-cells = <0x1>;
		#size-cells = <0x1>;
		linux,phandle = <0x94>;
		phandle = <0x94>;

		io-domains {
			compatible = "rockchip,rk3399-pmu-io-voltage-domain";
			status = "okay";
			pmu1830-supply = <0x82>;
		};

		reboot-mode {
			compatible = "syscon-reboot-mode";
			offset = <0x300>;
			mode-bootloader = <0x5242c301>;
			mode-charge = <0x5242c30b>;
			mode-fastboot = <0x5242c309>;
			mode-loader = <0x5242c301>;
			mode-normal = <0x5242c300>;
			mode-recovery = <0x5242c303>;
			mode-ums = <0x5242c30c>;
		};

		pmu-pvtm {
			compatible = "rockchip,rk3399-pmu-pvtm";
			clocks = <0x32 0x7>;
			clock-names = "pmu";
			resets = <0x8 0x1b>;
			reset-names = "pmu";
			status = "disabled";
		};
	};

	spi@ff350000 {
		compatible = "rockchip,rk3399-spi", "rockchip,rk3066-spi";
		reg = <0x0 0xff350000 0x0 0x1000>;
		clocks = <0x32 0x3 0x32 0x1f>;
		clock-names = "spiclk", "apb_pclk";
		interrupts = <0x0 0x3c 0x4 0x0>;
		pinctrl-names = "default";
		pinctrl-0 = <0x83 0x84 0x85 0x86>;
		#address-cells = <0x1>;
		#size-cells = <0x0>;
		status = "disabled";
	};

	serial@ff370000 {
		compatible = "rockchip,rk3399-uart", "snps,dw-apb-uart";
		reg = <0x0 0xff370000 0x0 0x100>;
		clocks = <0x32 0x6 0x32 0x22>;
		clock-names = "baudclk", "apb_pclk";
		interrupts = <0x0 0x66 0x4 0x0>;
		reg-shift = <0x2>;
		reg-io-width = <0x4>;
		pinctrl-names = "default";
		pinctrl-0 = <0x87>;
		status = "disabled";
		assigned-clocks = <0x32 0xc>;
		assigned-clock-parents = <0x32 0x1>;
	};

	i2c@ff3d0000 {
		compatible = "rockchip,rk3399-i2c";
		reg = <0x0 0xff3d0000 0x0 0x1000>;
		clocks = <0x32 0xa 0x32 0x1c>;
		clock-names = "i2c", "pclk";
		interrupts = <0x0 0x38 0x4 0x0>;
		pinctrl-names = "default";
		pinctrl-0 = <0x88>;
		#address-cells = <0x1>;
		#size-cells = <0x0>;
		status = "okay";
		i2c-scl-rising-time-ns = <0x258>;
		i2c-scl-falling-time-ns = <0x14>;

		fusb30x@22 {
			compatible = "fairchild,fusb302";
			reg = <0x22>;
			pinctrl-names = "default";
			pinctrl-0 = <0x89>;
			int-n-gpios = <0x36 0x2 0x0>;
			vbus-5v-gpios = <0x42 0x0 0x0>;
			status = "okay";
			linux,phandle = <0x28>;
			phandle = <0x28>;
		};

		mpu6500@68 {
			status = "okay";
			compatible = "invensense,mpu6500";
			reg = <0x68>;
			irq-gpio = <0x36 0x16 0x1>;
			mpu-int_config = <0x10>;
			mpu-level_shifter = <0x0>;
			mpu-orientation = <0x0 0x1 0x0 0x1 0x0 0x0 0x0 0x0 0x1>;
			orientation-x = <0x1>;
			orientation-y = <0x0>;
			orientation-z = <0x0>;
			mpu-debug = <0x1>;
		};

		cm32181@10 {
			status = "okay";
			compatible = "capella,cm32181";
			reg = <0x10>;
		};

		ak09911@0c {
			status = "okay";
			compatible = "ak,ak09911";
			reg = <0xc>;
			type = <0x3>;
			poll_delay_ms = <0x1e>;
			layout = <0x3>;
		};

		lsm6ds3_gyro@6a {
			status = "okay";
			compatible = "lsm6ds3_gyro";
			reg = <0x6a>;
			pinctrl-names = "default";
			pinctrl-0 = <0x8a>;
			irq-gpio = <0x36 0x18 0x1>;
			type = <0x4>;
			irq_enable = <0x1>;
			power-off-in-suspend = <0x1>;
			poll_delay_ms = <0x1e>;
		};
	};

	i2c@ff3e0000 {
		compatible = "rockchip,rk3399-i2c";
		reg = <0x0 0xff3e0000 0x0 0x1000>;
		clocks = <0x32 0xb 0x32 0x1d>;
		clock-names = "i2c", "pclk";
		interrupts = <0x0 0x3a 0x4 0x0>;
		pinctrl-names = "default";
		pinctrl-0 = <0x8b>;
		#address-cells = <0x1>;
		#size-cells = <0x0>;
		status = "disabled";
	};

	phy@e220 {
		compatible = "rockchip,rk3399-pcie-phy";
		#phy-cells = <0x0>;
		rockchip,grf = <0x15>;
		clocks = <0x8 0x8a>;
		clock-names = "refclk";
		resets = <0x8 0x87>;
		reset-names = "phy";
		status = "okay";
		linux,phandle = <0x8e>;
		phandle = <0x8e>;
	};

	pcie@f8000000 {
		compatible = "rockchip,rk3399-pcie";
		#address-cells = <0x3>;
		#size-cells = <0x2>;
		aspm-no-l0s;
		clocks = <0x8 0xc5 0x8 0xc4 0x8 0x147 0x8 0xa0>;
		clock-names = "aclk", "aclk-perf", "hclk", "pm";
		bus-range = <0x0 0x1f>;
		max-link-speed = <0x1>;
		linux,pci-domain = <0x0>;
		msi-map = <0x0 0x8c 0x0 0x1000>;
		interrupts = <0x0 0x31 0x4 0x0 0x0 0x32 0x4 0x0 0x0 0x33 0x4 0x0>;
		interrupt-names = "sys", "legacy", "client";
		#interrupt-cells = <0x1>;
		interrupt-map-mask = <0x0 0x0 0x0 0x7>;
		interrupt-map = <0x0 0x0 0x0 0x1 0x8d 0x0 0x0 0x0 0x0 0x2 0x8d 0x1 0x0 0x0 0x0 0x3 0x8d 0x2 0x0 0x0 0x0 0x4 0x8d 0x3>;
		phys = <0x8e>;
		phy-names = "pcie-phy";
		ranges = <0x83000000 0x0 0xfa000000 0x0 0xfa000000 0x0 0x1e00000 0x81000000 0x0 0xfbe00000 0x0 0xfbe00000 0x0 0x100000>;
		reg = <0x0 0xf8000000 0x0 0x2000000 0x0 0xfd000000 0x0 0x1000000>;
		reg-names = "axi-base", "apb-base";
		resets = <0x8 0x82 0x8 0x83 0x8 0x84 0x8 0x85 0x8 0x86 0x8 0x81 0x8 0x80>;
		reset-names = "core", "mgmt", "mgmt-sticky", "pipe", "pm", "pclk", "aclk";
		status = "okay";
		ep-gpios = <0x42 0x4 0x0>;
		num-lanes = <0x4>;
		pinctrl-names = "default";
		pinctrl-0 = <0x8f>;

		interrupt-controller {
			interrupt-controller;
			#address-cells = <0x0>;
			#interrupt-cells = <0x1>;
			linux,phandle = <0x8d>;
			phandle = <0x8d>;
		};
	};

	pwm@ff420000 {
		compatible = "rockchip,rk3399-pwm", "rockchip,rk3288-pwm";
		reg = <0x0 0xff420000 0x0 0x10>;
		#pwm-cells = <0x3>;
		pinctrl-names = "default";
		pinctrl-0 = <0x90>;
		clocks = <0x32 0x1e>;
		clock-names = "pwm";
		status = "okay";
		linux,phandle = <0xca>;
		phandle = <0xca>;
	};

	pwm@ff420010 {
		compatible = "rockchip,rk3399-pwm", "rockchip,rk3288-pwm";
		reg = <0x0 0xff420010 0x0 0x10>;
		#pwm-cells = <0x3>;
		pinctrl-names = "default";
		pinctrl-0 = <0x91>;
		clocks = <0x32 0x1e>;
		clock-names = "pwm";
		status = "disabled";
	};

	pwm@ff420020 {
		compatible = "rockchip,rk3399-pwm", "rockchip,rk3288-pwm";
		reg = <0x0 0xff420020 0x0 0x10>;
		#pwm-cells = <0x3>;
		pinctrl-names = "default";
		pinctrl-0 = <0x92>;
		clocks = <0x32 0x1e>;
		clock-names = "pwm";
		status = "okay";
		linux,phandle = <0xd1>;
		phandle = <0xd1>;
	};

	pwm@ff420030 {
		compatible = "rockchip,remotectl-pwm";
		reg = <0x0 0xff420030 0x0 0x10>;
		#pwm-cells = <0x3>;
		pinctrl-names = "default";
		pinctrl-0 = <0x93>;
		clocks = <0x32 0x1e>;
		clock-names = "pwm";
		status = "okay";
		interrupts = <0x0 0x3d 0x4 0x0>;
		remote_pwm_id = <0x3>;
		handle_cpu_id = <0x0>;

		ir_key1 {
			rockchip,usercode = <0xfb04>;
			rockchip,key_table = <0xa3 0x1c 0xe4 0x184 0xf5 0x9e 0xbb 0x67 0xe2 0x6c 0xe3 0x69 0xb7 0x6a 0xe0 0x66 0xba 0x73 0xda 0x73 0xe6 0x72 0xdb 0x72 0xbc 0xd9 0xb2 0x74 0xe5 0x74 0xde 0x74 0xdc 0x71 0xa2 0x8b 0xec 0x2 0xef 0x3 0xee 0x4 0xf0 0x5 0xf3 0x6 0xf2 0x7 0xf4 0x8 0xf7 0x9 0xf6 0xa 0xb8 0xb>;
		};
	};

	dfi@ff630000 {
		reg = <0x0 0xff630000 0x0 0x4000>;
		compatible = "rockchip,rk3399-dfi";
		rockchip,pmu = <0x94>;
		clocks = <0x8 0x179>;
		clock-names = "pclk_ddr_mon";
		status = "disabled";
		linux,phandle = <0x95>;
		phandle = <0x95>;
	};

	dmc {
		compatible = "rockchip,rk3399-dmc";
		devfreq-events = <0x95>;
		interrupts = <0x0 0x1 0x4 0x0>;
		clocks = <0x8 0xaa>;
		clock-names = "dmc_clk";
		ddr_timing = <0x96>;
		upthreshold = <0x28>;
		downdifferential = <0x14>;
		system-status-freq = <0x1 0xc3500 0x8 0x80e80 0x2 0x30d40 0x20 0x493e0 0x10 0x927c0 0x10000 0xc3500 0x2000 0xc3500 0x1000 0x61a80 0xc00 0x927c0 0x4000 0x927c0>;
		auto-min-freq = <0x61a80>;
		auto-freq-en = <0x1>;
		status = "disabled";
		operating-points-v2 = <0x97>;
	};

	vpu_service@ff650000 {
		compatible = "rockchip,vpu_service";
		rockchip,grf = <0x15>;
		iommus = <0x98>;
		iommu_enabled = <0x1>;
		reg = <0x0 0xff650000 0x0 0x800>;
		interrupts = <0x0 0x71 0x4 0x0 0x0 0x72 0x4 0x0>;
		interrupt-names = "irq_dec", "irq_enc";
		clocks = <0x8 0xeb 0x8 0x1ea>;
		clock-names = "aclk_vcodec", "hclk_vcodec";
		resets = <0x8 0x53 0x8 0x51>;
		reset-names = "video_h", "video_a";
		power-domains = <0x16 0x1f>;
		dev_mode = <0x0>;
		allocator = <0x1>;
		status = "okay";
	};

	iommu@ff650800 {
		compatible = "rockchip,iommu";
		reg = <0x0 0xff650800 0x0 0x40>;
		interrupts = <0x0 0x73 0x4 0x0>;
		interrupt-names = "vpu_mmu";
		clocks = <0x8 0xeb 0x8 0x1ea>;
		clock-names = "aclk", "hclk";
		power-domains = <0x16 0x1f>;
		#iommu-cells = <0x0>;
		linux,phandle = <0x98>;
		phandle = <0x98>;
	};

	rkvdec@ff660000 {
		compatible = "rockchip,rkvdec";
		rockchip,grf = <0x15>;
		iommus = <0x99>;
		iommu_enabled = <0x1>;
		reg = <0x0 0xff660000 0x0 0x400>;
		interrupts = <0x0 0x74 0x4 0x0>;
		interrupt-names = "irq_dec";
		clocks = <0x8 0xed 0x8 0x1ec 0x8 0x9f 0x8 0x9e>;
		clock-names = "aclk_vcodec", "hclk_vcodec", "clk_cabac", "clk_core";
		resets = <0x8 0x5b 0x8 0x59 0x8 0x5c 0x8 0x5d 0x8 0x58 0x8 0x5a>;
		reset-names = "video_h", "video_a", "video_core", "video_cabac", "niu_a", "niu_h";
		power-domains = <0x16 0x20>;
		dev_mode = <0x2>;
		allocator = <0x1>;
		status = "okay";
	};

	iommu@ff660480 {
		compatible = "rockchip,iommu";
		reg = <0x0 0xff660480 0x0 0x40 0x0 0xff6604c0 0x0 0x40>;
		interrupts = <0x0 0x75 0x4 0x0>;
		interrupt-names = "vdec_mmu";
		clocks = <0x8 0xed 0x8 0x1ec>;
		clock-names = "aclk", "hclk";
		power-domains = <0x16 0x20>;
		#iommu-cells = <0x0>;
		linux,phandle = <0x99>;
		phandle = <0x99>;
	};

	iep@ff670000 {
		compatible = "rockchip,iep";
		iommu_enabled = <0x1>;
		iommus = <0x9a>;
		reg = <0x0 0xff670000 0x0 0x800>;
		interrupts = <0x0 0x2a 0x4 0x0>;
		clocks = <0x8 0xe1 0x8 0x1dd>;
		clock-names = "aclk_iep", "hclk_iep";
		power-domains = <0x16 0x22>;
		allocator = <0x1>;
		version = <0x2>;
		status = "disabled";
	};

	iommu@ff670800 {
		compatible = "rockchip,iommu";
		reg = <0x0 0xff670800 0x0 0x40>;
		interrupts = <0x0 0x2a 0x4 0x0>;
		interrupt-names = "iep_mmu";
		#iommu-cells = <0x0>;
		status = "disabled";
		linux,phandle = <0x9a>;
		phandle = <0x9a>;
	};

	rga@ff680000 {
		compatible = "rockchip,rk3399-rga";
		reg = <0x0 0xff680000 0x0 0x10000>;
		interrupts = <0x0 0x37 0x4 0x0>;
		clocks = <0x8 0xdc 0x8 0x1e5 0x8 0x6d>;
		clock-names = "aclk", "hclk", "sclk";
		resets = <0x8 0x6a 0x8 0x67 0x8 0x69>;
		reset-names = "core", "axi", "ahb";
		power-domains = <0x16 0x21>;
		status = "disabled";
	};

	efuse@ff690000 {
		compatible = "rockchip,rk3399-efuse";
		reg = <0x0 0xff690000 0x0 0x80>;
		#address-cells = <0x1>;
		#size-cells = <0x1>;
		clocks = <0x8 0x17d>;
		clock-names = "pclk_efuse";

		id {
			reg = <0x7 0x10>;
		};

		cpul-leakage {
			reg = <0x1a 0x1>;
			linux,phandle = <0xc7>;
			phandle = <0xc7>;
		};

		cpub-leakage {
			reg = <0x17 0x1>;
			linux,phandle = <0xc8>;
			phandle = <0xc8>;
		};

		gpu-leakage {
			reg = <0x18 0x1>;
			linux,phandle = <0xc9>;
			phandle = <0xc9>;
		};

		center-leakage {
			reg = <0x19 0x1>;
		};

		logic-leakage {
			reg = <0x1b 0x1>;
		};

		wafer-info {
			reg = <0x1c 0x1>;
		};
	};

	pmu-clock-controller@ff750000 {
		compatible = "rockchip,rk3399-pmucru";
		reg = <0x0 0xff750000 0x0 0x1000>;
		#clock-cells = <0x1>;
		#reset-cells = <0x1>;
		assigned-clocks = <0x32 0x1>;
		assigned-clock-rates = <0x284af100>;
		linux,phandle = <0x32>;
		phandle = <0x32>;
	};

	clock-controller@ff760000 {
		compatible = "rockchip,rk3399-cru";
		reg = <0x0 0xff760000 0x0 0x1000>;
		#clock-cells = <0x1>;
		#reset-cells = <0x1>;
		assigned-clocks = <0x8 0xc0 0x8 0xc2 0x8 0x1c2 0x8 0x4c 0x8 0xf0 0x8 0xcd 0x8 0x1cd 0x8 0x9f 0x8 0x9e 0x8 0xf4 0x8 0xbe 0x8 0xc9 0x8 0x186 0x8 0xd5 0x8 0x88 0x8 0x87 0x8 0x8 0x8 0x9 0x8 0x6 0x8 0xd0 0x8 0x5 0x8 0xc0 0x8 0x1c0 0x8 0x140 0x8 0xc2 0x8 0x1c1 0x8 0x142 0x8 0x1c2 0x8 0x143 0x8 0x41 0x8 0x42 0x8 0x43 0x8 0x44 0x8 0x45 0x8 0x46 0x8 0x47 0x8 0x48 0x8 0x49 0x8 0x4a 0x8 0x4b 0x8 0xfa 0x8 0xe5 0x8 0xe6 0x8 0x6b 0x8 0x6c 0x8 0x16a 0x8 0xde 0x8 0xe3 0x8 0x1cd 0x8 0x85 0x8 0x86 0x8 0x4e 0x8 0xf0 0x8 0xcd 0x8 0xe1 0x8 0xdc 0x8 0x6d 0x8 0xed 0x8 0xeb 0x8 0x178 0x8 0xd5 0x8 0x9f 0x8 0x9e 0x8 0xf4 0x8 0xbe 0x8 0xc9 0x8 0x186 0x8 0x88 0x8 0x87 0x8 0xd9 0x8 0x1d9 0x8 0xdb 0x8 0x1db>;
		assigned-clock-rates = <0x47868c0 0x2faf080 0x2faf080 0x2faf080 0x2faf080 0x5f5e100 0x2faf080 0x8f0d180 0x8f0d180 0x8f0d180 0x2faf080 0x8f0d180 0x2faf080 0x5f5e100 0x47868c0 0x47868c0 0x30a32c00 0x30a32c00 0x23c34600 0xbebc200 0x2faf0800 0x8f0d180 0x47868c0 0x23c3460 0x5f5e100 0x5f5e100 0x2faf080 0x5f5e100 0x2faf080 0x5f5e100 0x5f5e100 0x5f5e100 0x5f5e100 0x5f5e100 0x5f5e100 0x2faf080 0x2faf080 0x2faf080 0x2faf080 0x2faf080 0xbebc200 0x17d78400 0x17d78400 0x5f5e100 0x5f5e100 0x5f5e100 0x17d78400 0x17d78400 0xbebc200 0x5f5e100 0xbebc200 0xbebc200 0x5f5e100 0x17d78400 0x17d78400 0x17d78400 0x17d78400 0x11e1a300 0x17d78400 0xbebc200 0x17d78400 0x11e1a300 0x11e1a300 0x11e1a300 0x11e1a300 0x11e1a300 0x5f5e100 0x8f0d180 0x8f0d180 0x17d78400 0x5f5e100 0x17d78400 0x5f5e100>;
		linux,phandle = <0x8>;
		phandle = <0x8>;
	};

	syscon@ff770000 {
		compatible = "rockchip,rk3399-grf", "syscon", "simple-mfd";
		reg = <0x0 0xff770000 0x0 0x10000>;
		#address-cells = <0x1>;
		#size-cells = <0x1>;
		linux,phandle = <0x15>;
		phandle = <0x15>;

		io-domains {
			compatible = "rockchip,rk3399-io-voltage-domain";
			status = "okay";
			bt656-supply = <0x82>;
			audio-supply = <0x9b>;
			sdmmc-supply = <0x20>;
			gpio1830-supply = <0x82>;
		};

		phy@f780 {
			compatible = "rockchip,rk3399-emmc-phy";
			reg = <0xf780 0x24>;
			clocks = <0x9c>;
			clock-names = "emmcclk";
			#phy-cells = <0x0>;
			status = "okay";
			linux,phandle = <0x25>;
			phandle = <0x25>;
		};

		usb2-phy@e450 {
			compatible = "rockchip,rk3399-usb2phy";
			reg = <0xe450 0x10>;
			clocks = <0x8 0x7b>;
			clock-names = "phyclk";
			#clock-cells = <0x0>;
			clock-output-names = "clk_usbphy0_480m";
			status = "okay";
			extcon = <0x28>;

			otg-port {
				#phy-cells = <0x0>;
				interrupts = <0x0 0x67 0x4 0x0 0x0 0x68 0x4 0x0 0x0 0x6a 0x4 0x0>;
				interrupt-names = "otg-bvalid", "otg-id", "linestate";
				status = "okay";
				linux,phandle = <0x29>;
				phandle = <0x29>;
			};

			host-port {
				#phy-cells = <0x0>;
				interrupts = <0x0 0x1b 0x4 0x0>;
				interrupt-names = "linestate";
				status = "okay";
				phy-supply = <0x9d>;
				linux,phandle = <0x26>;
				phandle = <0x26>;
			};
		};

		usb2-phy@e460 {
			compatible = "rockchip,rk3399-usb2phy";
			reg = <0xe460 0x10>;
			clocks = <0x8 0x7c>;
			clock-names = "phyclk";
			#clock-cells = <0x0>;
			clock-output-names = "clk_usbphy1_480m";
			status = "okay";

			otg-port {
				#phy-cells = <0x0>;
				interrupts = <0x0 0x6c 0x4 0x0 0x0 0x6d 0x4 0x0 0x0 0x6f 0x4 0x0>;
				interrupt-names = "otg-bvalid", "otg-id", "linestate";
				status = "okay";
				linux,phandle = <0x2b>;
				phandle = <0x2b>;
			};

			host-port {
				#phy-cells = <0x0>;
				interrupts = <0x0 0x1f 0x4 0x0>;
				interrupt-names = "linestate";
				status = "okay";
				phy-supply = <0x9d>;
				linux,phandle = <0x27>;
				phandle = <0x27>;
			};
		};

		pvtm {
			compatible = "rockchip,rk3399-pvtm";
			clocks = <0x8 0x73 0x8 0x74 0x8 0x75 0x8 0x76>;
			clock-names = "core_l", "core_b", "gpu", "ddr";
			resets = <0x8 0x1f 0x8 0x2f 0x8 0x123 0x8 0x4f>;
			reset-names = "core_l", "core_b", "gpu", "ddr";
			status = "disabled";
		};
	};

	phy@ff7c0000 {
		compatible = "rockchip,rk3399-typec-phy";
		reg = <0x0 0xff7c0000 0x0 0x40000>;
		rockchip,grf = <0x15>;
		#phy-cells = <0x1>;
		clocks = <0x8 0x7e 0x8 0x7d>;
		clock-names = "tcpdcore", "tcpdphy-ref";
		assigned-clocks = <0x8 0x7e>;
		assigned-clock-rates = <0x2faf080>;
		power-domains = <0x16 0x8>;
		resets = <0x8 0x95 0x8 0x94 0x8 0x14c>;
		reset-names = "uphy", "uphy-pipe", "uphy-tcphy";
		rockchip,typec-conn-dir = <0xe580 0x0 0x10>;
		rockchip,usb3tousb2-en = <0xe580 0x3 0x13>;
		rockchip,usb3-host-disable = <0x2434 0x0 0x10>;
		rockchip,usb3-host-port = <0x2434 0xc 0x1c>;
		rockchip,external-psm = <0xe588 0xe 0x1e>;
		rockchip,pipe-status = <0xe5c0 0x0 0x0>;
		rockchip,uphy-dp-sel = <0x6268 0x13 0x13>;
		status = "okay";
		extcon = <0x28>;

		dp-port {
			#phy-cells = <0x0>;
			linux,phandle = <0x2d>;
			phandle = <0x2d>;
		};

		usb3-port {
			#phy-cells = <0x0>;
			linux,phandle = <0x2a>;
			phandle = <0x2a>;
		};
	};

	phy@ff800000 {
		compatible = "rockchip,rk3399-typec-phy";
		reg = <0x0 0xff800000 0x0 0x40000>;
		rockchip,grf = <0x15>;
		#phy-cells = <0x1>;
		clocks = <0x8 0x80 0x8 0x7f>;
		clock-names = "tcpdcore", "tcpdphy-ref";
		assigned-clocks = <0x8 0x80>;
		assigned-clock-rates = <0x2faf080>;
		power-domains = <0x16 0x9>;
		resets = <0x8 0x9d 0x8 0x9c 0x8 0x14d>;
		reset-names = "uphy", "uphy-pipe", "uphy-tcphy";
		rockchip,typec-conn-dir = <0xe58c 0x0 0x10>;
		rockchip,usb3tousb2-en = <0xe58c 0x3 0x13>;
		rockchip,usb3-host-disable = <0x2444 0x0 0x10>;
		rockchip,usb3-host-port = <0x2444 0xc 0x1c>;
		rockchip,external-psm = <0xe594 0xe 0x1e>;
		rockchip,pipe-status = <0xe5c0 0x10 0x10>;
		rockchip,uphy-dp-sel = <0x6268 0x3 0x13>;
		status = "okay";

		dp-port {
			#phy-cells = <0x0>;
			linux,phandle = <0x2e>;
			phandle = <0x2e>;
		};

		usb3-port {
			#phy-cells = <0x0>;
			linux,phandle = <0x2c>;
			phandle = <0x2c>;
		};
	};

	watchdog@ff848000 {
		compatible = "snps,dw-wdt";
		reg = <0x0 0xff848000 0x0 0x100>;
		clocks = <0x8 0x17c>;
		interrupts = <0x0 0x78 0x4 0x0>;
	};

	rktimer@ff850000 {
		compatible = "rockchip,rk3399-timer";
		reg = <0x0 0xff850000 0x0 0x1000>;
		interrupts = <0x0 0x51 0x4 0x0>;
		clocks = <0x8 0x168 0x8 0x5a>;
		clock-names = "pclk", "timer";
	};

	spdif@ff870000 {
		compatible = "rockchip,rk3399-spdif";
		reg = <0x0 0xff870000 0x0 0x1000>;
		interrupts = <0x0 0x42 0x4 0x0>;
		dmas = <0x9e 0x7>;
		dma-names = "tx";
		clock-names = "mclk", "hclk";
		clocks = <0x8 0x55 0x8 0x1d7>;
		pinctrl-names = "default";
		pinctrl-0 = <0x9f>;
		power-domains = <0x16 0x1c>;
		status = "okay";
		i2c-scl-rising-time-ns = <0x1c2>;
		i2c-scl-falling-time-ns = <0xf>;
		#sound-dai-cells = <0x0>;
		assigned-clocks = <0x8 0xb1>;
		assigned-clock-parents = <0x8 0x5>;
		linux,phandle = <0xd4>;
		phandle = <0xd4>;
	};

	i2s@ff880000 {
		compatible = "rockchip,rk3399-i2s", "rockchip,rk3066-i2s";
		reg = <0x0 0xff880000 0x0 0x1000>;
		rockchip,grf = <0x15>;
		interrupts = <0x0 0x27 0x4 0x0>;
		dmas = <0x9e 0x0 0x9e 0x1>;
		dma-names = "tx", "rx";
		clock-names = "i2s_clk", "i2s_hclk";
		clocks = <0x8 0x56 0x8 0x1d4>;
		pinctrl-names = "default";
		pinctrl-0 = <0xa0>;
		power-domains = <0x16 0x1c>;
		status = "okay";
		rockchip,i2s-broken-burst-len;
		rockchip,playback-channels = <0x8>;
		rockchip,capture-channels = <0x8>;
		#sound-dai-cells = <0x0>;
		assigned-clocks = <0x8 0xae>;
		assigned-clock-parents = <0x8 0x5>;
		linux,phandle = <0xd2>;
		phandle = <0xd2>;
	};

	i2s@ff890000 {
		compatible = "rockchip,rk3399-i2s", "rockchip,rk3066-i2s";
		reg = <0x0 0xff890000 0x0 0x1000>;
		interrupts = <0x0 0x28 0x4 0x0>;
		dmas = <0x9e 0x2 0x9e 0x3>;
		dma-names = "tx", "rx";
		clock-names = "i2s_clk", "i2s_hclk";
		clocks = <0x8 0x57 0x8 0x1d5>;
		pinctrl-names = "default";
		pinctrl-0 = <0xa1>;
		power-domains = <0x16 0x1c>;
		status = "disabled";
		assigned-clocks = <0x8 0xaf>;
		assigned-clock-parents = <0x8 0x5>;
	};

	i2s@ff8a0000 {
		compatible = "rockchip,rk3399-i2s", "rockchip,rk3066-i2s";
		reg = <0x0 0xff8a0000 0x0 0x1000>;
		interrupts = <0x0 0x29 0x4 0x0>;
		dmas = <0x9e 0x4 0x9e 0x5>;
		dma-names = "tx", "rx";
		clock-names = "i2s_clk", "i2s_hclk";
		clocks = <0x8 0x58 0x8 0x1d6>;
		power-domains = <0x16 0x1c>;
		status = "okay";
		#sound-dai-cells = <0x0>;
		assigned-clocks = <0x8 0xb0>;
		assigned-clock-parents = <0x8 0x5>;
		linux,phandle = <0xcb>;
		phandle = <0xcb>;
	};

	gpu@ff9a0000 {
		compatible = "arm,malit860", "arm,malit86x", "arm,malit8xx", "arm,mali-midgard";
		reg = <0x0 0xff9a0000 0x0 0x10000>;
		interrupts = <0x0 0x13 0x4 0x0 0x0 0x14 0x4 0x0 0x0 0x15 0x4 0x0>;
		interrupt-names = "GPU", "JOB", "MMU";
		clocks = <0x8 0xd0>;
		clock-names = "clk_mali";
		#cooling-cells = <0x2>;
		power-domains = <0x16 0x23>;
		power-off-delay-ms = <0xc8>;
		status = "okay";
		operating-points-v2 = <0xa2>;
		mali-supply = <0xa3>;
		linux,phandle = <0x66>;
		phandle = <0x66>;

		power_model {
			compatible = "arm,mali-simple-power-model";
			voltage = <0x384>;
			frequency = <0x1f4>;
			static-power = <0x12c>;
			dynamic-power = <0x18c>;
			ts = <0x7d00 0x125c 0xffffffb0 0x2>;
			thermal-zone = "gpu-thermal";
		};
	};

	vop@ff8f0000 {
		compatible = "rockchip,rk3399-vop-lit";
		reg = <0x0 0xff8f0000 0x0 0x600 0x0 0xff8f1c00 0x0 0x200 0x0 0xff8f2000 0x0 0x400>;
		reg-names = "regs", "cabc_lut", "gamma_lut";
		interrupts = <0x0 0x77 0x4 0x0>;
		clocks = <0x8 0xdb 0x8 0xb5 0x8 0x1db 0x8 0xb7>;
		clock-names = "aclk_vop", "dclk_vop", "hclk_vop", "dclk_source";
		resets = <0x8 0x113 0x8 0x117 0x8 0x119>;
		reset-names = "axi", "ahb", "dclk";
		power-domains = <0x16 0x12>;
		iommus = <0xa4>;
		status = "okay";

		port {
			#address-cells = <0x1>;
			#size-cells = <0x0>;
			linux,phandle = <0xc0>;
			phandle = <0xc0>;

			endpoint@0 {
				reg = <0x0>;
				remote-endpoint = <0xa5>;
				linux,phandle = <0xb6>;
				phandle = <0xb6>;
			};

			endpoint@1 {
				reg = <0x1>;
				remote-endpoint = <0xa6>;
				linux,phandle = <0xbd>;
				phandle = <0xbd>;
			};

			endpoint@2 {
				reg = <0x2>;
				remote-endpoint = <0xa7>;
				linux,phandle = <0xb4>;
				phandle = <0xb4>;
			};

			endpoint@3 {
				reg = <0x3>;
				remote-endpoint = <0xa8>;
				linux,phandle = <0x30>;
				phandle = <0x30>;
			};

			endpoint@4 {
				reg = <0x4>;
				remote-endpoint = <0xa9>;
				linux,phandle = <0xba>;
				phandle = <0xba>;
			};
		};
	};

	voppwm@ff8f01a0 {
		compatible = "rockchip,vop-pwm";
		reg = <0x0 0xff8f01a0 0x0 0x10>;
		#pwm-cells = <0x3>;
		pinctrl-names = "default";
		pinctrl-0 = <0xaa>;
		clocks = <0x8 0x6c>;
		clock-names = "pwm";
		status = "disabled";
	};

	iommu@ff8f3f00 {
		compatible = "rockchip,iommu";
		reg = <0x0 0xff8f3f00 0x0 0x100>;
		interrupts = <0x0 0x77 0x4 0x0>;
		interrupt-names = "vopl_mmu";
		clocks = <0x8 0xdb 0x8 0x1db>;
		clock-names = "aclk", "hclk";
		power-domains = <0x16 0x12>;
		#iommu-cells = <0x0>;
		status = "okay";
		linux,phandle = <0xa4>;
		phandle = <0xa4>;
	};

	vop@ff900000 {
		compatible = "rockchip,rk3399-vop-big";
		reg = <0x0 0xff900000 0x0 0x600 0x0 0xff901c00 0x0 0x200 0x0 0xff902000 0x0 0x1000>;
		reg-names = "regs", "cabc_lut", "gamma_lut";
		interrupts = <0x0 0x76 0x4 0x0>;
		clocks = <0x8 0xd9 0x8 0xb4 0x8 0x1d9 0x8 0xb6>;
		clock-names = "aclk_vop", "dclk_vop", "hclk_vop", "dclk_source";
		resets = <0x8 0x112 0x8 0x116 0x8 0x118>;
		reset-names = "axi", "ahb", "dclk";
		power-domains = <0x16 0x11>;
		iommus = <0xab>;
		status = "okay";

		port {
			#address-cells = <0x1>;
			#size-cells = <0x0>;
			linux,phandle = <0xbf>;
			phandle = <0xbf>;

			endpoint@0 {
				reg = <0x0>;
				remote-endpoint = <0xac>;
				linux,phandle = <0xbc>;
				phandle = <0xbc>;
			};

			endpoint@1 {
				reg = <0x1>;
				remote-endpoint = <0xad>;
				linux,phandle = <0xb5>;
				phandle = <0xb5>;
			};

			endpoint@2 {
				reg = <0x2>;
				remote-endpoint = <0xae>;
				linux,phandle = <0xb3>;
				phandle = <0xb3>;
			};

			endpoint@3 {
				reg = <0x3>;
				remote-endpoint = <0xaf>;
				linux,phandle = <0x2f>;
				phandle = <0x2f>;
			};

			endpoint@4 {
				reg = <0x4>;
				remote-endpoint = <0xb0>;
				linux,phandle = <0xb9>;
				phandle = <0xb9>;
			};
		};
	};

	voppwm@ff9001a0 {
		compatible = "rockchip,vop-pwm";
		reg = <0x0 0xff9001a0 0x0 0x10>;
		#pwm-cells = <0x3>;
		pinctrl-names = "default";
		pinctrl-0 = <0xb1>;
		clocks = <0x8 0x6b>;
		clock-names = "pwm";
		status = "disabled";
	};

	iommu@ff903f00 {
		compatible = "rockchip,iommu";
		reg = <0x0 0xff903f00 0x0 0x100>;
		interrupts = <0x0 0x76 0x4 0x0>;
		interrupt-names = "vopb_mmu";
		clocks = <0x8 0xd9 0x8 0x1d9>;
		clock-names = "aclk", "hclk";
		power-domains = <0x16 0x11>;
		#iommu-cells = <0x0>;
		status = "okay";
		linux,phandle = <0xab>;
		phandle = <0xab>;
	};

	iommu@ff914000 {
		compatible = "rockchip,iommu";
		reg = <0x0 0xff914000 0x0 0x100 0x0 0xff915000 0x0 0x100>;
		interrupts = <0x0 0x2b 0x4 0x0>;
		interrupt-names = "isp0_mmu";
		#iommu-cells = <0x0>;
		clocks = <0x8 0xe7 0x8 0x1e1>;
		clock-names = "aclk", "hclk";
		power-domains = <0x16 0x13>;
		rk_iommu,disable_reset_quirk;
		status = "okay";
		linux,phandle = <0xd8>;
		phandle = <0xd8>;
	};

	iommu@ff924000 {
		compatible = "rockchip,iommu";
		reg = <0x0 0xff924000 0x0 0x100 0x0 0xff925000 0x0 0x100>;
		interrupts = <0x0 0x2c 0x4 0x0>;
		interrupt-names = "isp1_mmu";
		#iommu-cells = <0x0>;
		clocks = <0x8 0xe8 0x8 0x1e2>;
		clock-names = "aclk", "hclk";
		power-domains = <0x16 0x14>;
		rk_iommu,disable_reset_quirk;
		status = "disabled";
		linux,phandle = <0xda>;
		phandle = <0xda>;
	};

	hdmi@ff940000 {
		compatible = "rockchip,rk3399-dw-hdmi";
		reg = <0x0 0xff940000 0x0 0x20000>;
		reg-io-width = <0x4>;
		rockchip,grf = <0x15>;
		pinctrl-names = "default";
		pinctrl-0 = <0xb2>;
		power-domains = <0x16 0x15>;
		interrupts = <0x0 0x17 0x4 0x0>;
		clocks = <0x8 0x174 0x8 0x71 0x8 0x7 0x8 0x16f>;
		clock-names = "iahb", "isfr", "vpll", "grf";
		status = "okay";
		#address-cells = <0x1>;
		#size-cells = <0x0>;
		#sound-dai-cells = <0x0>;
		linux,phandle = <0xcc>;
		phandle = <0xcc>;

		ports {

			port {
				#address-cells = <0x1>;
				#size-cells = <0x0>;

				endpoint@0 {
					reg = <0x0>;
					remote-endpoint = <0xb3>;
					linux,phandle = <0xae>;
					phandle = <0xae>;
				};

				endpoint@1 {
					reg = <0x1>;
					remote-endpoint = <0xb4>;
					linux,phandle = <0xa7>;
					phandle = <0xa7>;
				};
			};
		};
	};

	dsi@ff960000 {
		compatible = "rockchip,rk3399-mipi-dsi";
		reg = <0x0 0xff960000 0x0 0x8000>;
		interrupts = <0x0 0x2d 0x4 0x0>;
		clocks = <0x8 0xa2 0x8 0x170 0x8 0xa3>;
		clock-names = "ref", "pclk", "phy_cfg";
		resets = <0x8 0xfb>;
		reset-names = "apb";
		power-domains = <0x16 0xf>;
		rockchip,grf = <0x15>;
		#address-cells = <0x1>;
		#size-cells = <0x0>;
		status = "disable";

		ports {

			port {
				#address-cells = <0x1>;
				#size-cells = <0x0>;

				endpoint@0 {
					reg = <0x0>;
					remote-endpoint = <0xb5>;
					linux,phandle = <0xad>;
					phandle = <0xad>;
				};

				endpoint@1 {
					reg = <0x1>;
					remote-endpoint = <0xb6>;
					linux,phandle = <0xa5>;
					phandle = <0xa5>;
				};
			};
		};

		panel@0 {
			status = "disable";
			compatible = "simple-panel-dsi";
			reg = <0x0>;
			backlight = <0xb7>;
			enable-gpios = <0x36 0xd 0x0>;
			reset-gpios = <0x3f 0x1e 0x1>;
			reset-delay-ms = <0x5>;
			init-delay-ms = <0xc8>;
			prepare-delay-ms = <0xf>;
			dsi,flags = <0x803>;
			dsi,format = <0x0>;
			bus-format = <0x100a>;
			dsi,lanes = <0x4>;
			panel-init-sequence = [39 00 06 f0 55 aa 52 08 00 39 00 03 b1 68 01 39 00 02 b6 08 39 00 04 b8 01 02 08 39 00 03 bb 44 44 39 00 03 bc 00 00 39 00 06 bd 02 68 10 10 00 39 00 02 c8 80 39 00 06 f0 55 aa 52 08 01 39 00 03 b3 4f 4f 39 00 03 b4 10 10 39 00 03 b5 05 05 39 00 03 b9 35 35 39 00 04 ba ba 25 25 39 00 03 bc 68 00 39 00 03 bd 68 00 39 00 02 be 30 39 00 02 c0 0c 39 00 02 ca 00 39 00 06 f0 55 aa 52 08 02 39 00 02 ee 01 39 00 11 b0 00 00 00 0f 00 2a 00 40 00 54 00 76 00 93 00 c5 39 00 11 b1 00 f0 01 32 01 66 01 bb 01 ff 02 01 02 42 02 85 39 00 11 b2 02 af 02 e0 03 05 03 35 03 54 03 84 03 a0 03 c4 39 00 05 b3 03 f2 03 ff 39 00 06 f0 55 aa 52 08 03 39 00 03 b0 00 00 39 00 03 b1 00 00 39 00 06 b2 08 00 17 00 00 39 00 06 b6 05 00 00 00 00 39 00 06 ba 53 00 a0 00 00 39 00 06 bb 53 00 a0 00 00 39 00 05 c0 00 00 00 00 39 00 05 c1 00 00 00 00 39 00 02 c4 60 39 00 02 c5 c0 39 00 06 f0 55 aa 52 08 05 39 00 03 b0 17 06 39 00 03 b1 17 06 39 00 03 b2 17 06 39 00 03 b3 17 06 39 00 03 b4 17 06 39 00 03 b5 17 06 39 00 02 b8 0c 39 00 02 b9 00 39 00 02 ba 00 39 00 02 bb 0a 39 00 02 bc 02 39 00 06 bd 03 01 01 03 03 39 00 02 c0 07 39 00 02 c4 a2 39 00 03 c8 03 20 39 00 03 c9 01 21 39 00 04 cc 00 00 01 39 00 04 cd 00 00 01 39 00 06 d1 00 04 fc 07 14 39 00 06 d2 10 05 00 03 16 39 00 02 e5 06 39 00 02 e6 06 39 00 02 e7 06 39 00 02 e8 06 39 00 02 e9 06 39 00 02 ea 06 39 00 02 ed 30 39 00 06 f0 55 aa 52 08 06 39 00 03 b0 17 11 39 00 03 b1 16 10 39 00 03 b2 12 18 39 00 03 b3 13 19 39 00 03 b4 00 31 39 00 03 b5 31 34 39 00 03 b6 34 29 39 00 03 b7 2a 33 39 00 03 b8 2e 2d 39 00 03 b9 08 34 39 00 03 ba 34 08 39 00 03 bb 2d 2e 39 00 03 bc 34 2a 39 00 03 bd 29 34 39 00 03 be 13 03 39 00 03 bf 31 00 39 00 03 c0 19 13 39 00 03 c1 18 12 39 00 03 c2 10 16 39 00 03 c3 11 17 39 00 03 e5 34 34 39 00 03 c4 12 18 39 00 03 c5 13 19 39 00 03 c6 17 11 39 00 03 c7 16 10 39 00 03 c8 08 31 39 00 03 c9 31 34 39 00 03 ca 34 29 39 00 03 cb 2a 33 39 00 03 cc 2d 2e 39 00 03 cd 00 34 39 00 03 ce 34 00 39 00 03 cf 2e 2d 39 00 03 d0 34 2a 39 00 03 d1 29 2a 39 00 03 d2 34 31 39 00 03 d3 31 08 39 00 03 d4 10 16 39 00 03 d5 11 17 39 00 03 d6 19 13 39 00 03 d7 18 12 39 00 03 e6 34 34 39 00 06 d8 00 00 00 00 00 39 00 06 d9 00 00 00 00 00 39 00 02 e7 00 05 78 01 11 05 14 01 29 39 00 02 35 00 39 14 06 f0 55 aa 52 08 01];
			panel-exit-sequence = <0x5000128 0x5780110>;

			display-timings {
				native-mode = <0xb8>;

				timing0 {
					clock-frequency = <0x4692680>;
					screen-type = <0x7>;
					out-face = <0x0>;
					hactive = <0x320>;
					vactive = <0x500>;
					hback-porch = <0x3b>;
					hfront-porch = <0x10>;
					vback-porch = <0x3>;
					vfront-porch = <0x8>;
					hsync-len = <0x5>;
					vsync-len = <0x5>;
					hsync-active = <0x0>;
					vsync-active = <0x0>;
					de-active = <0x0>;
					pixelclk-active = <0x0>;
					swap-rb = <0x0>;
					swap-rg = <0x0>;
					swap-gb = <0x0>;
					linux,phandle = <0xb8>;
					phandle = <0xb8>;
				};
			};
		};
	};

	dsi@ff968000 {
		compatible = "rockchip,rk3399-mipi-dsi";
		reg = <0x0 0xff968000 0x0 0x8000>;
		interrupts = <0x0 0x2e 0x4 0x0>;
		clocks = <0x8 0xa2 0x8 0x171 0x8 0xa4>;
		clock-names = "ref", "pclk", "phy_cfg";
		resets = <0x8 0xfc>;
		reset-names = "apb";
		power-domains = <0x16 0xf>;
		rockchip,grf = <0x15>;
		#address-cells = <0x1>;
		#size-cells = <0x0>;
		status = "disabled";

		ports {

			port {
				#address-cells = <0x1>;
				#size-cells = <0x0>;

				endpoint@0 {
					reg = <0x0>;
					remote-endpoint = <0xb9>;
					linux,phandle = <0xb0>;
					phandle = <0xb0>;
				};

				endpoint@1 {
					reg = <0x1>;
					remote-endpoint = <0xba>;
					linux,phandle = <0xa9>;
					phandle = <0xa9>;
				};
			};
		};
	};

	edp@ff970000 {
		compatible = "rockchip,rk3399-edp";
		reg = <0x0 0xff970000 0x0 0x8000>;
		interrupts = <0x0 0xa 0x4 0x0>;
		clocks = <0x8 0x16a 0x8 0x16c>;
		clock-names = "dp", "pclk";
		power-domains = <0x16 0x19>;
		resets = <0x8 0x11d>;
		reset-names = "dp";
		rockchip,grf = <0x15>;
		status = "disabled";
		pinctrl-names = "default";
		pinctrl-0 = <0xbb>;

		ports {
			#address-cells = <0x1>;
			#size-cells = <0x0>;

			port@0 {
				reg = <0x0>;
				#address-cells = <0x1>;
				#size-cells = <0x0>;

				endpoint@0 {
					reg = <0x0>;
					remote-endpoint = <0xbc>;
					linux,phandle = <0xac>;
					phandle = <0xac>;
				};

				endpoint@1 {
					reg = <0x1>;
					remote-endpoint = <0xbd>;
					linux,phandle = <0xa6>;
					phandle = <0xa6>;
				};
			};

			port@1 {
				reg = <0x1>;
				#address-cells = <0x1>;
				#size-cells = <0x0>;

				endpoint@0 {
					reg = <0x0>;
					remote-endpoint = <0xbe>;
					linux,phandle = <0xde>;
					phandle = <0xde>;
				};
			};
		};
	};

	display-subsystem {
		compatible = "rockchip,display-subsystem";
		ports = <0xbf 0xc0>;
		clocks = <0x8 0x7 0x8 0x4>;
		clock-names = "hdmi-tmds-pll", "default-vop-pll";
		status = "okay";
		logo-memory-region = <0xc1>;

		route {

			route-hdmi {
				status = "disabled";
				logo,uboot = "logo.bmp";
				logo,kernel = "logo_kernel.bmp";
				logo,mode = "fullscreen";
				charge_logo,mode = "center";
				connect = <0xb4>;
			};

			route-dsi {
				status = "disabled";
				logo,uboot = "logo.bmp";
				logo,kernel = "logo_kernel.bmp";
				logo,mode = "fullscreen";
				charge_logo,mode = "center";
				connect = <0xb5>;
			};

			route-edp {
				status = "disabled";
				logo,uboot = "logo.bmp";
				logo,kernel = "logo_kernel.bmp";
				logo,mode = "fullscreen";
				charge_logo,mode = "center";
				connect = <0xbc>;
			};
		};
	};

	nocp-cci-msch0@ffa86000 {
		compatible = "rockchip,rk3399-nocp";
		reg = <0x0 0xffa86000 0x0 0x400>;
	};

	nocp-gpu-msch0@ffa86400 {
		compatible = "rockchip,rk3399-nocp";
		reg = <0x0 0xffa86400 0x0 0x400>;
	};

	nocp-hp-msch0@ffa86800 {
		compatible = "rockchip,rk3399-nocp";
		reg = <0x0 0xffa86800 0x0 0x400>;
	};

	nocp-lp-msch0@ffa86c00 {
		compatible = "rockchip,rk3399-nocp";
		reg = <0x0 0xffa86c00 0x0 0x400>;
	};

	nocp-video-msch0@ffa87000 {
		compatible = "rockchip,rk3399-nocp";
		reg = <0x0 0xffa87000 0x0 0x400>;
	};

	nocp-vio0-msch0@ffa87400 {
		compatible = "rockchip,rk3399-nocp";
		reg = <0x0 0xffa87400 0x0 0x400>;
	};

	nocp-vio1-msch0@ffa87800 {
		compatible = "rockchip,rk3399-nocp";
		reg = <0x0 0xffa87800 0x0 0x400>;
	};

	nocp-cci-msch1@ffa8e000 {
		compatible = "rockchip,rk3399-nocp";
		reg = <0x0 0xffa8e000 0x0 0x400>;
	};

	nocp-gpu-msch1@ffa8e400 {
		compatible = "rockchip,rk3399-nocp";
		reg = <0x0 0xffa8e400 0x0 0x400>;
	};

	nocp-hp-msch1@ffa8e800 {
		compatible = "rockchip,rk3399-nocp";
		reg = <0x0 0xffa8e800 0x0 0x400>;
	};

	nocp-lp-msch1@ffa8ec00 {
		compatible = "rockchip,rk3399-nocp";
		reg = <0x0 0xffa8ec00 0x0 0x400>;
	};

	nocp-video-msch1@ffa8f000 {
		compatible = "rockchip,rk3399-nocp";
		reg = <0x0 0xffa8f000 0x0 0x400>;
	};

	nocp-vio0-msch1@ffa8f400 {
		compatible = "rockchip,rk3399-nocp";
		reg = <0x0 0xffa8f400 0x0 0x400>;
	};

	nocp-vio1-msch1@ffa8f800 {
		compatible = "rockchip,rk3399-nocp";
		reg = <0x0 0xffa8f800 0x0 0x400>;
	};

	pinctrl {
		compatible = "rockchip,rk3399-pinctrl";
		rockchip,grf = <0x15>;
		rockchip,pmu = <0x94>;
		#address-cells = <0x2>;
		#size-cells = <0x2>;
		ranges;

		gpio0@ff720000 {
			compatible = "rockchip,gpio-bank";
			reg = <0x0 0xff720000 0x0 0x100>;
			clocks = <0x32 0x17>;
			interrupts = <0x0 0xe 0x4 0x0>;
			gpio-controller;
			#gpio-cells = <0x2>;
			interrupt-controller;
			#interrupt-cells = <0x2>;
			linux,phandle = <0x3e>;
			phandle = <0x3e>;
		};

		gpio1@ff730000 {
			compatible = "rockchip,gpio-bank";
			reg = <0x0 0xff730000 0x0 0x100>;
			clocks = <0x32 0x18>;
			interrupts = <0x0 0xf 0x4 0x0>;
			gpio-controller;
			#gpio-cells = <0x2>;
			interrupt-controller;
			#interrupt-cells = <0x2>;
			linux,phandle = <0x36>;
			phandle = <0x36>;
		};

		gpio2@ff780000 {
			compatible = "rockchip,gpio-bank";
			reg = <0x0 0xff780000 0x0 0x100>;
			clocks = <0x8 0x150>;
			interrupts = <0x0 0x10 0x4 0x0>;
			gpio-controller;
			#gpio-cells = <0x2>;
			interrupt-controller;
			#interrupt-cells = <0x2>;
			linux,phandle = <0x42>;
			phandle = <0x42>;
		};

		gpio3@ff788000 {
			compatible = "rockchip,gpio-bank";
			reg = <0x0 0xff788000 0x0 0x100>;
			clocks = <0x8 0x151>;
			interrupts = <0x0 0x11 0x4 0x0>;
			gpio-controller;
			#gpio-cells = <0x2>;
			interrupt-controller;
			#interrupt-cells = <0x2>;
			linux,phandle = <0x18>;
			phandle = <0x18>;
		};

		gpio4@ff790000 {
			compatible = "rockchip,gpio-bank";
			reg = <0x0 0xff790000 0x0 0x100>;
			clocks = <0x8 0x152>;
			interrupts = <0x0 0x12 0x4 0x0>;
			gpio-controller;
			#gpio-cells = <0x2>;
			interrupt-controller;
			#interrupt-cells = <0x2>;
			linux,phandle = <0x3f>;
			phandle = <0x3f>;
		};

		pcfg-pull-up {
			bias-pull-up;
			linux,phandle = <0xc2>;
			phandle = <0xc2>;
		};

		pcfg-pull-down {
			bias-pull-down;
			linux,phandle = <0xc6>;
			phandle = <0xc6>;
		};

		pcfg-pull-none {
			bias-disable;
			linux,phandle = <0xc4>;
			phandle = <0xc4>;
		};

		pcfg-pull-up-20ma {
			bias-pull-up;
			drive-strength = <0x14>;
		};

		pcfg-pull-none-20ma {
			bias-disable;
			drive-strength = <0x14>;
		};

		pcfg-pull-none-18ma {
			bias-disable;
			drive-strength = <0x12>;
		};

		pcfg-pull-none-12ma {
			bias-disable;
			drive-strength = <0xc>;
			linux,phandle = <0xc5>;
			phandle = <0xc5>;
		};

		pcfg-pull-up-8ma {
			bias-pull-up;
			drive-strength = <0x8>;
		};

		pcfg-pull-down-4ma {
			bias-pull-down;
			drive-strength = <0x4>;
		};

		pcfg-pull-up-2ma {
			bias-pull-up;
			drive-strength = <0x2>;
		};

		pcfg-pull-down-12ma {
			bias-pull-down;
			drive-strength = <0xc>;
		};

		pcfg-pull-none-13ma {
			bias-disable;
			drive-strength = <0xd>;
			linux,phandle = <0xc3>;
			phandle = <0xc3>;
		};

		pcfg-output-high {
			output-high;
		};

		pcfg-output-low {
			output-low;
		};

		pcfg-input {
			input-enable;
		};

		emmc {

			emmc-pwr {
				rockchip,pins = <0x0 0x5 0x1 0xc2>;
			};
		};

		gmac {

			rgmii-pins {
				rockchip,pins = <0x3 0x11 0x1 0xc3 0x3 0xe 0x1 0xc4 0x3 0xd 0x1 0xc4 0x3 0xc 0x1 0xc3 0x3 0xb 0x1 0xc4 0x3 0x9 0x1 0xc4 0x3 0x8 0x1 0xc4 0x3 0x7 0x1 0xc4 0x3 0x6 0x1 0xc4 0x3 0x5 0x1 0xc3 0x3 0x4 0x1 0xc3 0x3 0x3 0x1 0xc4 0x3 0x2 0x1 0xc4 0x3 0x1 0x1 0xc3 0x3 0x0 0x1 0xc3>;
				linux,phandle = <0x1a>;
				phandle = <0x1a>;
			};

			rmii-pins {
				rockchip,pins = <0x3 0xd 0x1 0xc4 0x3 0xc 0x1 0xc3 0x3 0xb 0x1 0xc4 0x3 0xa 0x1 0xc4 0x3 0x9 0x1 0xc4 0x3 0x8 0x1 0xc4 0x3 0x7 0x1 0xc4 0x3 0x6 0x1 0xc4 0x3 0x5 0x1 0xc3 0x3 0x4 0x1 0xc3>;
			};
		};

		i2c0 {

			i2c0-xfer {
				rockchip,pins = <0x1 0xf 0x2 0xc4 0x1 0x10 0x2 0xc4>;
				linux,phandle = <0x33>;
				phandle = <0x33>;
			};
		};

		i2c1 {

			i2c1-xfer {
				rockchip,pins = <0x4 0x2 0x1 0xc4 0x4 0x1 0x1 0xc4>;
				linux,phandle = <0x3c>;
				phandle = <0x3c>;
			};
		};

		i2c2 {

			i2c2-xfer {
				rockchip,pins = <0x2 0x1 0x2 0xc5 0x2 0x0 0x2 0xc5>;
				linux,phandle = <0x44>;
				phandle = <0x44>;
			};
		};

		i2c3 {

			i2c3-xfer {
				rockchip,pins = <0x4 0x11 0x1 0xc4 0x4 0x10 0x1 0xc4>;
				linux,phandle = <0x45>;
				phandle = <0x45>;
			};

			i2c3_gpio {
				rockchip,pins = <0x4 0x11 0x0 0xc4 0x4 0x10 0x0 0xc4>;
			};
		};

		i2c4 {

			i2c4-xfer {
				rockchip,pins = <0x1 0xc 0x1 0xc4 0x1 0xb 0x1 0xc4>;
				linux,phandle = <0x88>;
				phandle = <0x88>;
			};
		};

		i2c5 {

			i2c5-xfer {
				rockchip,pins = <0x3 0xb 0x2 0xc4 0x3 0xa 0x2 0xc4>;
				linux,phandle = <0x46>;
				phandle = <0x46>;
			};
		};

		i2c6 {

			i2c6-xfer {
				rockchip,pins = <0x2 0xa 0x2 0xc4 0x2 0x9 0x2 0xc4>;
				linux,phandle = <0x47>;
				phandle = <0x47>;
			};
		};

		i2c7 {

			i2c7-xfer {
				rockchip,pins = <0x2 0x8 0x2 0xc4 0x2 0x7 0x2 0xc4>;
				linux,phandle = <0x48>;
				phandle = <0x48>;
			};
		};

		i2c8 {

			i2c8-xfer {
				rockchip,pins = <0x1 0x15 0x1 0xc4 0x1 0x14 0x1 0xc4>;
				linux,phandle = <0x8b>;
				phandle = <0x8b>;
			};
		};

		i2s0 {

			i2s0-8ch-bus {
				rockchip,pins = <0x3 0x18 0x1 0xc4 0x3 0x19 0x1 0xc4 0x3 0x1a 0x1 0xc4 0x3 0x1b 0x1 0xc4 0x3 0x1c 0x1 0xc4 0x3 0x1d 0x1 0xc4 0x3 0x1e 0x1 0xc4 0x3 0x1f 0x1 0xc4>;
				linux,phandle = <0xa0>;
				phandle = <0xa0>;
			};

			i2s-8ch-mclk {
				rockchip,pins = <0x4 0x0 0x1 0xc4>;
				linux,phandle = <0x3d>;
				phandle = <0x3d>;
			};
		};

		i2s1 {

			i2s1-2ch-bus {
				rockchip,pins = <0x4 0x3 0x1 0xc4 0x4 0x4 0x1 0xc4 0x4 0x5 0x1 0xc4 0x4 0x6 0x1 0xc4 0x4 0x7 0x1 0xc4>;
				linux,phandle = <0xa1>;
				phandle = <0xa1>;
			};
		};

		sdio0 {

			sdio0-bus1 {
				rockchip,pins = <0x2 0x14 0x1 0xc2>;
			};

			sdio0-bus4 {
				rockchip,pins = <0x2 0x14 0x1 0xc2 0x2 0x15 0x1 0xc2 0x2 0x16 0x1 0xc2 0x2 0x17 0x1 0xc2>;
				linux,phandle = <0x1c>;
				phandle = <0x1c>;
			};

			sdio0-cmd {
				rockchip,pins = <0x2 0x18 0x1 0xc2>;
				linux,phandle = <0x1d>;
				phandle = <0x1d>;
			};

			sdio0-clk {
				rockchip,pins = <0x2 0x19 0x1 0xc4>;
				linux,phandle = <0x1e>;
				phandle = <0x1e>;
			};

			sdio0-cd {
				rockchip,pins = <0x2 0x1a 0x1 0xc2>;
			};

			sdio0-pwr {
				rockchip,pins = <0x2 0x1b 0x1 0xc2>;
			};

			sdio0-bkpwr {
				rockchip,pins = <0x2 0x1c 0x1 0xc2>;
			};

			sdio0-wp {
				rockchip,pins = <0x0 0x3 0x1 0xc2>;
			};

			sdio0-int {
				rockchip,pins = <0x0 0x4 0x1 0xc2>;
			};
		};

		sdmmc {

			sdmmc-bus1 {
				rockchip,pins = <0x4 0x8 0x1 0xc2>;
			};

			sdmmc-bus4 {
				rockchip,pins = <0x4 0x8 0x1 0xc2 0x4 0x9 0x1 0xc2 0x4 0xa 0x1 0xc2 0x4 0xb 0x1 0xc2>;
				linux,phandle = <0x24>;
				phandle = <0x24>;
			};

			sdmmc-clk {
				rockchip,pins = <0x4 0xc 0x1 0xc4>;
				linux,phandle = <0x21>;
				phandle = <0x21>;
			};

			sdmmc-cmd {
				rockchip,pins = <0x4 0xd 0x1 0xc2>;
				linux,phandle = <0x22>;
				phandle = <0x22>;
			};

			sdmcc-cd {
				rockchip,pins = <0x0 0x7 0x1 0xc2>;
				linux,phandle = <0x23>;
				phandle = <0x23>;
			};

			sdmmc-wp {
				rockchip,pins = <0x0 0x8 0x1 0xc2>;
			};
		};

		spdif {

			spdif-bus {
				rockchip,pins = <0x4 0x15 0x1 0xc4>;
				linux,phandle = <0x9f>;
				phandle = <0x9f>;
			};

			spdif-bus-1 {
				rockchip,pins = <0x3 0x10 0x3 0xc4>;
			};
		};

		spi0 {

			spi0-clk {
				rockchip,pins = <0x3 0x6 0x2 0xc2>;
				linux,phandle = <0x50>;
				phandle = <0x50>;
			};

			spi0-cs0 {
				rockchip,pins = <0x3 0x7 0x2 0xc2>;
				linux,phandle = <0x53>;
				phandle = <0x53>;
			};

			spi0-cs1 {
				rockchip,pins = <0x3 0x8 0x2 0xc2>;
			};

			spi0-tx {
				rockchip,pins = <0x3 0x5 0x2 0xc2>;
				linux,phandle = <0x51>;
				phandle = <0x51>;
			};

			spi0-rx {
				rockchip,pins = <0x3 0x4 0x2 0xc2>;
				linux,phandle = <0x52>;
				phandle = <0x52>;
			};
		};

		spi1 {

			spi1-clk {
				rockchip,pins = <0x1 0x9 0x2 0xc2>;
				linux,phandle = <0x54>;
				phandle = <0x54>;
			};

			spi1-cs0 {
				rockchip,pins = <0x1 0xa 0x2 0xc2>;
				linux,phandle = <0x57>;
				phandle = <0x57>;
			};

			spi1-rx {
				rockchip,pins = <0x1 0x7 0x2 0xc2>;
				linux,phandle = <0x56>;
				phandle = <0x56>;
			};

			spi1-tx {
				rockchip,pins = <0x1 0x8 0x2 0xc2>;
				linux,phandle = <0x55>;
				phandle = <0x55>;
			};
		};

		spi2 {

			spi2-clk {
				rockchip,pins = <0x2 0xb 0x1 0xc2>;
				linux,phandle = <0x58>;
				phandle = <0x58>;
			};

			spi2-cs0 {
				rockchip,pins = <0x2 0xc 0x1 0xc2>;
				linux,phandle = <0x5b>;
				phandle = <0x5b>;
			};

			spi2-rx {
				rockchip,pins = <0x2 0x9 0x1 0xc2>;
				linux,phandle = <0x5a>;
				phandle = <0x5a>;
			};

			spi2-tx {
				rockchip,pins = <0x2 0xa 0x1 0xc2>;
				linux,phandle = <0x59>;
				phandle = <0x59>;
			};
		};

		spi3 {

			spi3-clk {
				rockchip,pins = <0x1 0x11 0x1 0xc2>;
				linux,phandle = <0x83>;
				phandle = <0x83>;
			};

			spi3-cs0 {
				rockchip,pins = <0x1 0x12 0x1 0xc2>;
				linux,phandle = <0x86>;
				phandle = <0x86>;
			};

			spi3-rx {
				rockchip,pins = <0x1 0xf 0x1 0xc2>;
				linux,phandle = <0x85>;
				phandle = <0x85>;
			};

			spi3-tx {
				rockchip,pins = <0x1 0x10 0x1 0xc2>;
				linux,phandle = <0x84>;
				phandle = <0x84>;
			};
		};

		spi4 {

			spi4-clk {
				rockchip,pins = <0x3 0x2 0x2 0xc2>;
				linux,phandle = <0x5c>;
				phandle = <0x5c>;
			};

			spi4-cs0 {
				rockchip,pins = <0x3 0x3 0x2 0xc2>;
				linux,phandle = <0x5f>;
				phandle = <0x5f>;
			};

			spi4-rx {
				rockchip,pins = <0x3 0x0 0x2 0xc2>;
				linux,phandle = <0x5e>;
				phandle = <0x5e>;
			};

			spi4-tx {
				rockchip,pins = <0x3 0x1 0x2 0xc2>;
				linux,phandle = <0x5d>;
				phandle = <0x5d>;
			};
		};

		spi5 {

			spi5-clk {
				rockchip,pins = <0x2 0x16 0x2 0xc2>;
				linux,phandle = <0x60>;
				phandle = <0x60>;
			};

			spi5-cs0 {
				rockchip,pins = <0x2 0x17 0x2 0xc2>;
				linux,phandle = <0x63>;
				phandle = <0x63>;
			};

			spi5-rx {
				rockchip,pins = <0x2 0x14 0x2 0xc2>;
				linux,phandle = <0x62>;
				phandle = <0x62>;
			};

			spi5-tx {
				rockchip,pins = <0x2 0x15 0x2 0xc2>;
				linux,phandle = <0x61>;
				phandle = <0x61>;
			};
		};

		tsadc {

			otp-gpio {
				rockchip,pins = <0x1 0x6 0x0 0xc4>;
				linux,phandle = <0x67>;
				phandle = <0x67>;
			};

			otp-out {
				rockchip,pins = <0x1 0x6 0x1 0xc4>;
				linux,phandle = <0x68>;
				phandle = <0x68>;
			};
		};

		uart0 {

			uart0-xfer {
				rockchip,pins = <0x2 0x10 0x1 0xc2 0x2 0x11 0x1 0xc4>;
				linux,phandle = <0x49>;
				phandle = <0x49>;
			};

			uart0-cts {
				rockchip,pins = <0x2 0x12 0x1 0xc4>;
				linux,phandle = <0x4a>;
				phandle = <0x4a>;
			};

			uart0-rts {
				rockchip,pins = <0x2 0x13 0x1 0xc4>;
				linux,phandle = <0xd6>;
				phandle = <0xd6>;
			};
		};

		uart1 {

			uart1-xfer {
				rockchip,pins = <0x3 0xc 0x2 0xc2 0x3 0xd 0x2 0xc4>;
				linux,phandle = <0x4b>;
				phandle = <0x4b>;
			};
		};

		uart2a {

			uart2a-xfer {
				rockchip,pins = <0x4 0x8 0x2 0xc2 0x4 0x9 0x2 0xc4>;
			};
		};

		uart2b {

			uart2b-xfer {
				rockchip,pins = <0x4 0x10 0x2 0xc2 0x4 0x11 0x2 0xc4>;
			};
		};

		uart2c {

			uart2c-xfer {
				rockchip,pins = <0x4 0x13 0x1 0xc2 0x4 0x14 0x1 0xc4>;
				linux,phandle = <0x4c>;
				phandle = <0x4c>;
			};
		};

		uart3 {

			uart3-xfer {
				rockchip,pins = <0x3 0xe 0x2 0xc2 0x3 0xf 0x2 0xc4>;
				linux,phandle = <0x4d>;
				phandle = <0x4d>;
			};

			uart3-cts {
				rockchip,pins = <0x3 0x12 0x2 0xc4>;
				linux,phandle = <0x4e>;
				phandle = <0x4e>;
			};

			uart3-rts {
				rockchip,pins = <0x3 0x13 0x2 0xc4>;
				linux,phandle = <0x4f>;
				phandle = <0x4f>;
			};
		};

		uart4 {

			uart4-xfer {
				rockchip,pins = <0x1 0x7 0x1 0xc2 0x1 0x8 0x1 0xc4>;
				linux,phandle = <0x87>;
				phandle = <0x87>;
			};
		};

		uarthdcp {

			uarthdcp-xfer {
				rockchip,pins = <0x4 0x15 0x2 0xc2 0x4 0x16 0x2 0xc4>;
			};
		};

		pwm0 {

			pwm0-pin {
				rockchip,pins = <0x4 0x12 0x1 0xc4>;
				linux,phandle = <0x90>;
				phandle = <0x90>;
			};

			vop0-pwm-pin {
				rockchip,pins = <0x4 0x12 0x2 0xc4>;
				linux,phandle = <0xb1>;
				phandle = <0xb1>;
			};
		};

		pwm1 {

			pwm1-pin {
				rockchip,pins = <0x4 0x16 0x1 0xc4>;
				linux,phandle = <0x91>;
				phandle = <0x91>;
			};

			vop1-pwm-pin {
				rockchip,pins = <0x4 0x12 0x3 0xc4>;
				linux,phandle = <0xaa>;
				phandle = <0xaa>;
			};
		};

		pwm2 {

			pwm2-pin {
				rockchip,pins = <0x1 0x13 0x1 0xc4>;
				linux,phandle = <0x92>;
				phandle = <0x92>;
			};
		};

		pwm3a {

			pwm3a-pin {
				rockchip,pins = <0x0 0x6 0x1 0xc4>;
				linux,phandle = <0x93>;
				phandle = <0x93>;
			};
		};

		pwm3b {

			pwm3b-pin {
				rockchip,pins = <0x1 0xe 0x1 0xc4>;
			};
		};

		edp {

			edp-hpd {
				rockchip,pins = <0x4 0x17 0x2 0xc4>;
				linux,phandle = <0xbb>;
				phandle = <0xbb>;
			};
		};

		hdmi {

			hdmi-i2c-xfer {
				rockchip,pins = <0x4 0x11 0x3 0xc4 0x4 0x10 0x3 0xc4>;
				linux,phandle = <0xb2>;
				phandle = <0xb2>;
			};

			hdmi-cec {
				rockchip,pins = <0x4 0x17 0x1 0xc4>;
			};
		};

		pcie {

			pci-clkreqn {
				rockchip,pins = <0x2 0x1a 0x2 0xc4>;
				linux,phandle = <0x8f>;
				phandle = <0x8f>;
			};

			pci-clkreqnb {
				rockchip,pins = <0x4 0x18 0x1 0xc4>;
			};

			pci-clkreqn-cpm {
				rockchip,pins = <0x2 0x1a 0x0 0xc4>;
			};

			pci-clkreqnb-cpm {
				rockchip,pins = <0x4 0x18 0x0 0xc4>;
			};

			pcie-drv {
				rockchip,pins = <0x0 0x2 0x0 0xc4>;
				linux,phandle = <0xe1>;
				phandle = <0xe1>;
			};
		};

		pmic {

			pmic-int-l {
				rockchip,pins = <0x1 0x15 0x0 0xc2>;
				linux,phandle = <0x38>;
				phandle = <0x38>;
			};

			pmic-dvs2 {
				rockchip,pins = <0x1 0x12 0x0 0xc6>;
				linux,phandle = <0x39>;
				phandle = <0x39>;
			};

			vsel1-gpio {
				rockchip,pins = <0x1 0x11 0x0 0xc6>;
				linux,phandle = <0x35>;
				phandle = <0x35>;
			};

			vsel2-gpio {
				rockchip,pins = <0x1 0xe 0x0 0xc6>;
				linux,phandle = <0x37>;
				phandle = <0x37>;
			};
		};

		usb2 {

			host-vbus-drv {
				rockchip,pins = <0x4 0x19 0x0 0xc4>;
				linux,phandle = <0xcf>;
				phandle = <0xcf>;
			};
		};

		vcc_sd {

			vcc-sd-h {
				rockchip,pins = <0x0 0x1 0x0 0xc2>;
				linux,phandle = <0xd0>;
				phandle = <0xd0>;
			};
		};

		fusb30x {

			fusb0-int {
				rockchip,pins = <0x1 0x2 0x0 0xc2>;
				linux,phandle = <0x89>;
				phandle = <0x89>;
			};
		};

		sdio-pwrseq {

			wifi-enable-h {
				rockchip,pins = <0x0 0xa 0x0 0xc4>;
				linux,phandle = <0xce>;
				phandle = <0xce>;
			};
		};

		wireless-bluetooth {

			uart0-gpios {
				rockchip,pins = <0x2 0x13 0x0 0xc4>;
				linux,phandle = <0xd7>;
				phandle = <0xd7>;
			};
		};

		isp {

			cif-clkout {
				rockchip,pins = <0x2 0xb 0x3 0xc4>;
			};

			isp-dvp-d0d7 {
				rockchip,pins = <0x4 0x1b 0x0 0xc4 0x2 0xb 0x3 0xc4 0x2 0x0 0x3 0xc4 0x2 0x1 0x3 0xc4 0x2 0x2 0x3 0xc4 0x2 0x3 0x3 0xc4 0x2 0x4 0x3 0xc4 0x2 0x5 0x3 0xc4 0x2 0x6 0x3 0xc4 0x2 0x7 0x3 0xc4 0x2 0x8 0x3 0xc4 0x2 0x9 0x3 0xc4 0x2 0xa 0x3 0xc4>;
			};

			isp-shutter {
				rockchip,pins = <0x1 0x1 0x1 0xc4 0x1 0x0 0x1 0xc4>;
			};

			isp-flash-trigger {
				rockchip,pins = <0x1 0x3 0x1 0xc4>;
			};

			isp-flash-trigger-as-gpio {
				rockchip,pins = <0x0 0x11 0x0 0xc4>;
			};
		};

		cam_pins {

			cam0-default-pins {
				rockchip,pins = <0x4 0x1b 0x0 0xc4 0x2 0xb 0x3 0xc4 0x2 0xa 0x0 0xc2>;
				linux,phandle = <0x40>;
				phandle = <0x40>;
			};

			cam0-sleep-pins {
				rockchip,pins = <0x4 0x1b 0x3 0xc4 0x2 0xb 0x0 0xc4>;
				linux,phandle = <0x41>;
				phandle = <0x41>;
			};
		};

		buttons {

			pwrbtn {
				rockchip,pins = <0x0 0x5 0x0 0xc2>;
				linux,phandle = <0xe0>;
				phandle = <0xe0>;
			};
		};

		lsm6ds3_gyro {

			lsm6ds3-irq-gpio {
				rockchip,pins = <0x1 0x18 0x0 0xc4>;
				linux,phandle = <0x8a>;
				phandle = <0x8a>;
			};
		};

		hallsensor {

			mh248-irq-gpio {
				rockchip,pins = <0x0 0xd 0x0 0xc2>;
				linux,phandle = <0xdf>;
				phandle = <0xdf>;
			};
		};

		lcd-panel {

			lcd-panel-reset {
				rockchip,pins = <0x4 0x1e 0x0 0xc2>;
				linux,phandle = <0xdd>;
				phandle = <0xdd>;
			};
		};

		hdmiin {

			hdmiin-gpios {
				rockchip,pins = <0x2 0x5 0x0 0xc4 0x2 0x6 0x0 0xc4 0x2 0x7 0x0 0xc4 0x2 0x8 0x0 0xc4 0x2 0x9 0x0 0xc4 0x2 0xc 0x0 0xc4>;
				linux,phandle = <0x43>;
				phandle = <0x43>;
			};
		};
	};

	rockchip-suspend {
		compatible = "rockchip,pm-rk3399";
		status = "okay";
		rockchip,sleep-debug-en = <0x1>;
		rockchip,virtual-poweroff = <0x0>;
		rockchip,sleep-mode-config = <0xde>;
		rockchip,wakeup-config = <0x804>;
		rockchip,pwm-regulator-config = <0x4>;
		rockchip,power-ctrl = <0x36 0x11 0x0 0x36 0xe 0x0>;
	};

	energy-costs {

		rk3399-core-cost0 {
			busy-cost-data = <0x6c 0x2e 0x9f 0x43 0xd8 0x5a 0x10b 0x78 0x13e 0x99 0x177 0xc6 0x191 0xde>;
			idle-cost-data = <0x6 0x6 0x0 0x0>;
			linux,phandle = <0xc>;
			phandle = <0xc>;
		};

		rk3399-core-cost1 {
			busy-cost-data = <0xd2 0x81 0x134 0xb8 0x1a3 0xf6 0x206 0x14f 0x269 0x1ac 0x2d8 0x23d 0x33b 0x2d4 0x39d 0x384 0x400 0x454>;
			idle-cost-data = <0xf 0xf 0x0 0x0>;
			linux,phandle = <0x10>;
			phandle = <0x10>;
		};

		rk3399-cluster-cost0 {
			busy-cost-data = <0x6c 0x2e 0x9f 0x43 0xd8 0x5a 0x10b 0x78 0x13e 0x99 0x177 0xc6 0x191 0xde>;
			idle-cost-data = <0x38 0x38 0x38 0x38>;
			linux,phandle = <0xd>;
			phandle = <0xd>;
		};

		rk3399-cluster-cost1 {
			busy-cost-data = <0xd2 0x81 0x134 0xb8 0x1a3 0xf6 0x206 0x14f 0x269 0x1ac 0x2d8 0x23d 0x33b 0x2d4 0x39d 0x384 0x400 0x454>;
			idle-cost-data = <0x41 0x41 0x41 0x41>;
			linux,phandle = <0x11>;
			phandle = <0x11>;
		};
	};

	opp-table0 {
		compatible = "operating-points-v2";
		opp-shared;
		nvmem-cells = <0xc7>;
		nvmem-cell-names = "cpu_leakage";
		rockchip,pvtm-voltage-sel = <0x0 0x2308c 0x0 0x2308d 0x24414 0x1 0x24415 0x251c0 0x2 0x251c1 0xf423f 0x3>;
		rockchip,pvtm-freq = <0x639c0>;
		rockchip,pvtm-volt = <0xf4240>;
		rockchip,pvtm-ch = <0x0 0x0>;
		rockchip,pvtm-sample-time = <0x3e8>;
		rockchip,pvtm-number = <0xa>;
		rockchip,pvtm-error = <0x3e8>;
		rockchip,pvtm-ref-temp = <0x29>;
		rockchip,pvtm-temp-prop = <0x73 0x42>;
		rockchip,pvtm-thermal-zone = "soc-thermal";
		linux,phandle = <0xb>;
		phandle = <0xb>;

		opp-408000000 {
			opp-hz = <0x0 0x18519600>;
			opp-microvolt = <0xc3500>;
			opp-microvolt-L0 = <0xc3500>;
			opp-microvolt-L1 = <0xc3500>;
			opp-microvolt-L2 = <0xc3500>;
			opp-microvolt-L3 = <0xc3500>;
			clock-latency-ns = <0x9c40>;
		};

		opp-600000000 {
			opp-hz = <0x0 0x23c34600>;
			opp-microvolt = <0xc3500>;
			opp-microvolt-L0 = <0xc3500>;
			opp-microvolt-L1 = <0xc3500>;
			opp-microvolt-L2 = <0xc3500>;
			opp-microvolt-L3 = <0xc3500>;
			clock-latency-ns = <0x9c40>;
		};

		opp-816000000 {
			opp-hz = <0x0 0x30a32c00>;
			opp-microvolt = <0xcf850>;
			opp-microvolt-L0 = <0xcf850>;
			opp-microvolt-L1 = <0xc96a8>;
			opp-microvolt-L2 = <0xc3500>;
			opp-microvolt-L3 = <0xc3500>;
			clock-latency-ns = <0x9c40>;
			opp-suspend;
		};

		opp-1008000000 {
			opp-hz = <0x0 0x3c14dc00>;
			opp-microvolt = <0xe1d48>;
			opp-microvolt-L0 = <0xe1d48>;
			opp-microvolt-L1 = <0xdbba0>;
			opp-microvolt-L2 = <0xd59f8>;
			opp-microvolt-L3 = <0xcf850>;
			clock-latency-ns = <0x9c40>;
		};

		opp-1200000000 {
			opp-hz = <0x0 0x47868c00>;
			opp-microvolt = <0xf4240>;
			opp-microvolt-L0 = <0xf4240>;
			opp-microvolt-L1 = <0xee098>;
			opp-microvolt-L2 = <0xe7ef0>;
			opp-microvolt-L3 = <0xe1d48>;
			clock-latency-ns = <0x9c40>;
		};

		opp-1416000000 {
			opp-hz = <0x0 0x54667200>;
			opp-microvolt = <0x112a88>;
			opp-microvolt-L0 = <0x112a88>;
			opp-microvolt-L1 = <0x10c8e0>;
			opp-microvolt-L2 = <0x106738>;
			opp-microvolt-L3 = <0x100590>;
			clock-latency-ns = <0x9c40>;
		};
	};

	opp-table1 {
		compatible = "operating-points-v2";
		opp-shared;
		nvmem-cells = <0xc8>;
		nvmem-cell-names = "cpu_leakage";
		rockchip,pvtm-voltage-sel = <0x0 0x24608 0x0 0x24609 0x25d78 0x1 0x25d79 0x27100 0x2 0x27101 0xf423f 0x3>;
		rockchip,pvtm-freq = <0x639c0>;
		rockchip,pvtm-volt = <0xf4240>;
		rockchip,pvtm-ch = <0x1 0x0>;
		rockchip,pvtm-sample-time = <0x3e8>;
		rockchip,pvtm-number = <0xa>;
		rockchip,pvtm-error = <0x3e8>;
		rockchip,pvtm-ref-temp = <0x29>;
		rockchip,pvtm-temp-prop = <0x47 0x23>;
		rockchip,pvtm-thermal-zone = "soc-thermal";
		linux,phandle = <0xf>;
		phandle = <0xf>;

		opp-408000000 {
			opp-hz = <0x0 0x18519600>;
			opp-microvolt = <0xc3500>;
			opp-microvolt-L0 = <0xc3500>;
			opp-microvolt-L1 = <0xc3500>;
			opp-microvolt-L2 = <0xc3500>;
			opp-microvolt-L3 = <0xc3500>;
			clock-latency-ns = <0x9c40>;
		};

		opp-600000000 {
			opp-hz = <0x0 0x23c34600>;
			opp-microvolt = <0xc3500>;
			opp-microvolt-L0 = <0xc3500>;
			opp-microvolt-L1 = <0xc3500>;
			opp-microvolt-L2 = <0xc3500>;
			opp-microvolt-L3 = <0xc3500>;
			clock-latency-ns = <0x9c40>;
		};

		opp-816000000 {
			opp-hz = <0x0 0x30a32c00>;
			opp-microvolt = <0xc96a8>;
			opp-microvolt-L0 = <0xc96a8>;
			opp-microvolt-L1 = <0xc96a8>;
			opp-microvolt-L2 = <0xc3500>;
			opp-microvolt-L3 = <0xc3500>;
			clock-latency-ns = <0x9c40>;
			opp-suspend;
		};

		opp-1008000000 {
			opp-hz = <0x0 0x3c14dc00>;
			opp-microvolt = <0xd59f8>;
			opp-microvolt-L0 = <0xd59f8>;
			opp-microvolt-L1 = <0xcf850>;
			opp-microvolt-L2 = <0xcf850>;
			opp-microvolt-L3 = <0xcf850>;
			clock-latency-ns = <0x9c40>;
		};

		opp-1200000000 {
			opp-hz = <0x0 0x47868c00>;
			opp-microvolt = <0xe7ef0>;
			opp-microvolt-L0 = <0xe7ef0>;
			opp-microvolt-L1 = <0xe1d48>;
			opp-microvolt-L2 = <0xdbba0>;
			opp-microvolt-L3 = <0xd59f8>;
			clock-latency-ns = <0x9c40>;
		};

		opp-1416000000 {
			opp-hz = <0x0 0x54667200>;
			opp-microvolt = <0xfa3e8>;
			opp-microvolt-L0 = <0xfa3e8>;
			opp-microvolt-L1 = <0xf4240>;
			opp-microvolt-L2 = <0xf4240>;
			opp-microvolt-L3 = <0xee098>;
			clock-latency-ns = <0x9c40>;
		};

		opp-1608000000 {
			opp-hz = <0x0 0x5fd82200>;
			opp-microvolt = <0x10c8e0>;
			opp-microvolt-L0 = <0x10c8e0>;
			opp-microvolt-L1 = <0x106738>;
			opp-microvolt-L2 = <0x100590>;
			opp-microvolt-L3 = <0xfa3e8>;
			clock-latency-ns = <0x9c40>;
		};

		opp-1800000000 {
			opp-hz = <0x0 0x6b49d200>;
			opp-microvolt = <0x124f80>;
			opp-microvolt-L0 = <0x124f80>;
			opp-microvolt-L1 = <0x11edd8>;
			opp-microvolt-L2 = <0x118c30>;
			opp-microvolt-L3 = <0x112a88>;
			clock-latency-ns = <0x9c40>;
		};
	};

	opp-table2 {
		compatible = "operating-points-v2";
		nvmem-cells = <0xc9>;
		nvmem-cell-names = "gpu_leakage";
		rockchip,pvtm-voltage-sel = <0x0 0x1d8a8 0x0 0x1d8a9 0x1ea3c 0x1 0x1ea3d 0x1f5f4 0x2 0x1f5f5 0xf423f 0x3>;
		rockchip,pvtm-freq = <0x30d40>;
		rockchip,pvtm-volt = <0xdbba0>;
		rockchip,pvtm-ch = <0x3 0x0>;
		rockchip,pvtm-sample-time = <0x3e8>;
		rockchip,pvtm-number = <0xa>;
		rockchip,pvtm-error = <0x3e8>;
		rockchip,pvtm-ref-temp = <0x29>;
		rockchip,pvtm-temp-prop = <0x2e 0xc>;
		rockchip,pvtm-thermal-zone = "gpu-thermal";
		linux,phandle = <0xa2>;
		phandle = <0xa2>;

		opp-200000000 {
			opp-hz = <0x0 0xbebc200>;
			opp-microvolt = <0xc3500>;
			opp-microvolt-L0 = <0xc3500>;
			opp-microvolt-L1 = <0xc3500>;
			opp-microvolt-L2 = <0xc3500>;
			opp-microvolt-L3 = <0xc3500>;
		};

		opp-300000000 {
			opp-hz = <0x0 0x11e1a300>;
			opp-microvolt = <0xc3500>;
			opp-microvolt-L0 = <0xc3500>;
			opp-microvolt-L1 = <0xc3500>;
			opp-microvolt-L2 = <0xc3500>;
			opp-microvolt-L3 = <0xc3500>;
		};

		opp-400000000 {
			opp-hz = <0x0 0x17d78400>;
			opp-microvolt = <0xc96a8>;
			opp-microvolt-L0 = <0xc96a8>;
			opp-microvolt-L1 = <0xc96a8>;
			opp-microvolt-L2 = <0xc3500>;
			opp-microvolt-L3 = <0xc3500>;
		};

		opp-600000000 {
			opp-hz = <0x0 0x23c34600>;
			opp-microvolt = <0xe1d48>;
			opp-microvolt-L0 = <0xe1d48>;
			opp-microvolt-L1 = <0xe1d48>;
			opp-microvolt-L2 = <0xdbba0>;
			opp-microvolt-L3 = <0xdbba0>;
		};

		opp-800000000 {
			opp-hz = <0x0 0x2faf0800>;
			opp-microvolt = <0x10c8e0>;
			opp-microvolt-L0 = <0x10c8e0>;
			opp-microvolt-L1 = <0x106738>;
			opp-microvolt-L2 = <0x100590>;
			opp-microvolt-L3 = <0xfa3e8>;
		};
	};

	opp-table3 {
		compatible = "operating-points-v2";
		linux,phandle = <0x97>;
		phandle = <0x97>;

		opp-200000000 {
			opp-hz = <0x0 0xbebc200>;
			opp-microvolt = <0xc96a8>;
		};

		opp-300000000 {
			opp-hz = <0x0 0x11e1a300>;
			opp-microvolt = <0xcf850>;
		};

		opp-400000000 {
			opp-hz = <0x0 0x17d78400>;
			opp-microvolt = <0xcf850>;
		};

		opp-528000000 {
			opp-hz = <0x0 0x1f78a400>;
			opp-microvolt = <0xdbba0>;
		};

		opp-600000000 {
			opp-hz = <0x0 0x23c34600>;
			opp-microvolt = <0xdbba0>;
		};

		opp-800000000 {
			opp-hz = <0x0 0x2faf0800>;
			opp-microvolt = <0xdbba0>;
		};
	};

	backlight {
		status = "okay";
		compatible = "pwm-backlight";
		pwms = <0xca 0x0 0x61a8 0x0>;
		brightness-levels = <0x0 0x1 0x2 0x3 0x4 0x5 0x6 0x7 0x8 0x9 0xa 0xb 0xc 0xd 0xe 0xf 0x10 0x11 0x12 0x13 0x14 0x15 0x16 0x17 0x18 0x19 0x1a 0x1b 0x1c 0x1d 0x1e 0x1f 0x20 0x21 0x22 0x23 0x24 0x25 0x26 0x27 0x28 0x29 0x2a 0x2b 0x2c 0x2d 0x2e 0x2f 0x30 0x31 0x32 0x33 0x34 0x35 0x36 0x37 0x38 0x39 0x3a 0x3b 0x3c 0x3d 0x3e 0x3f 0x40 0x41 0x42 0x43 0x44 0x45 0x46 0x47 0x48 0x49 0x4a 0x4b 0x4c 0x4d 0x4e 0x4f 0x50 0x51 0x52 0x53 0x54 0x55 0x56 0x57 0x58 0x59 0x5a 0x5b 0x5c 0x5d 0x5e 0x5f 0x60 0x61 0x62 0x63 0x64 0x65 0x66 0x67 0x68 0x69 0x6a 0x6b 0x6c 0x6d 0x6e 0x6f 0x70 0x71 0x72 0x73 0x74 0x75 0x76 0x77 0x78 0x79 0x7a 0x7b 0x7c 0x7d 0x7e 0x7f 0x80 0x81 0x82 0x83 0x84 0x85 0x86 0x87 0x88 0x89 0x8a 0x8b 0x8c 0x8d 0x8e 0x8f 0x90 0x91 0x92 0x93 0x94 0x95 0x96 0x97 0x98 0x99 0x9a 0x9b 0x9c 0x9d 0x9e 0x9f 0xa0 0xa1 0xa2 0xa3 0xa4 0xa5 0xa6 0xa7 0xa8 0xa9 0xaa 0xab 0xac 0xad 0xae 0xaf 0xb0 0xb1 0xb2 0xb3 0xb4 0xb5 0xb6 0xb7 0xb8 0xb9 0xba 0xbb 0xbc 0xbd 0xbe 0xbf 0xc0 0xc1 0xc2 0xc3 0xc4 0xc5 0xc6 0xc7 0xc8 0xc9 0xca 0xcb 0xcc 0xcd 0xce 0xcf 0xd0 0xd1 0xd2 0xd3 0xd4 0xd5 0xd6 0xd7 0xd8 0xd9 0xda 0xdb 0xdc 0xdd 0xde 0xdf 0xe0 0xe1 0xe2 0xe3 0xe4 0xe5 0xe6 0xe7 0xe8 0xe9 0xea 0xeb 0xec 0xed 0xee 0xef 0xf0 0xf1 0xf2 0xf3 0xf4 0xf5 0xf6 0xf7 0xf8 0xf9 0xfa 0xfb 0xfc 0xfd 0xfe 0xff>;
		default-brightness-level = <0xc8>;
		linux,phandle = <0xb7>;
		phandle = <0xb7>;
	};

	external-gmac-clock {
		compatible = "fixed-clock";
		clock-frequency = <0x7735940>;
		clock-output-names = "clkin_gmac";
		#clock-cells = <0x0>;
		linux,phandle = <0x19>;
		phandle = <0x19>;
	};

	dw-hdmi-audio {
		status = "disabled";
		compatible = "rockchip,dw-hdmi-audio";
		#sound-dai-cells = <0x0>;
	};

	hdmi-sound {
		status = "disabled";
		compatible = "simple-audio-card";
		simple-audio-card,format = "i2s";
		simple-audio-card,mclk-fs = <0x100>;
		simple-audio-card,name = "rockchip,hdmi";

		simple-audio-card,cpu {
			sound-dai = <0xcb>;
		};

		simple-audio-card,codec {
			sound-dai = <0xcc>;
		};
	};

	sdio-pwrseq {
		compatible = "mmc-pwrseq-simple";
		clocks = <0xcd 0x1>;
		clock-names = "ext_clock";
		pinctrl-names = "default";
		pinctrl-0 = <0xce>;
		reset-gpios = <0x3e 0xa 0x1>;
		linux,phandle = <0x1b>;
		phandle = <0x1b>;
	};

	vcc3v3-sys {
		compatible = "regulator-fixed";
		regulator-name = "vcc3v3_sys";
		regulator-always-on;
		regulator-boot-on;
		regulator-min-microvolt = <0x325aa0>;
		regulator-max-microvolt = <0x325aa0>;
		linux,phandle = <0x3a>;
		phandle = <0x3a>;
	};

	vcc5v0-host-regulator {
		compatible = "regulator-fixed";
		enable-active-high;
		gpio = <0x3f 0x19 0x0>;
		pinctrl-names = "default";
		pinctrl-0 = <0xcf>;
		regulator-name = "vcc5v0_host";
		regulator-always-on;
		linux,phandle = <0x9d>;
		phandle = <0x9d>;
	};

	vcc5v0-sys {
		compatible = "regulator-fixed";
		regulator-name = "vcc5v0_sys";
		regulator-always-on;
		regulator-boot-on;
		regulator-min-microvolt = <0x4c4b40>;
		regulator-max-microvolt = <0x4c4b40>;
		linux,phandle = <0x34>;
		phandle = <0x34>;
	};

	vcc-sd {
		compatible = "regulator-fixed";
		enable-active-high;
		gpio = <0x3e 0x1 0x0>;
		pinctrl-names = "default";
		pinctrl-0 = <0xd0>;
		regulator-name = "vcc_sd";
		regulator-min-microvolt = <0x325aa0>;
		regulator-max-microvolt = <0x325aa0>;
		linux,phandle = <0x1f>;
		phandle = <0x1f>;
	};

	vcc-phy-regulator {
		compatible = "regulator-fixed";
		regulator-name = "vcc_phy";
		regulator-always-on;
		regulator-boot-on;
		linux,phandle = <0x17>;
		phandle = <0x17>;
	};

	vdd-log {
		compatible = "pwm-regulator";
		pwms = <0xd1 0x0 0x61a8 0x1>;
		regulator-name = "vdd_log";
		regulator-min-microvolt = <0xc3500>;
		regulator-max-microvolt = <0x155cc0>;
		regulator-always-on;
		regulator-boot-on;
		rockchip,pwm_id = <0x2>;
		rockchip,pwm_voltage = <0xf4240>;
	};

	rt5651-sound {
		compatible = "simple-audio-card";
		simple-audio-card,format = "i2s";
		simple-audio-card,name = "realtek,rt5651-codec";
		simple-audio-card,mclk-fs = <0x100>;
		simple-audio-card,widgets = "Microphone", "Mic Jack", "Headphone", "Headphone Jack";
		simple-audio-card,routing = "Mic Jack", "MICBIAS1", "IN1P", "Mic Jack", "Headphone Jack", "HPOL", "Headphone Jack", "HPOR";

		simple-audio-card,cpu {
			sound-dai = <0xd2>;
		};

		simple-audio-card,codec {
			sound-dai = <0xd3>;
		};
	};

	spdif-sound {
		status = "okay";
		compatible = "simple-audio-card";
		simple-audio-card,name = "ROCKCHIP,SPDIF";

		simple-audio-card,cpu {
			sound-dai = <0xd4>;
		};

		simple-audio-card,codec {
			sound-dai = <0xd5>;
		};
	};

	spdif-out {
		status = "okay";
		compatible = "linux,spdif-dit";
		#sound-dai-cells = <0x0>;
		linux,phandle = <0xd5>;
		phandle = <0xd5>;
	};

	wireless-wlan {
		compatible = "wlan-platdata";
		rockchip,grf = <0x15>;
		wifi_chip_type = "ap6356s";
		sdio_vref = <0x708>;
		WIFI,host_wake_irq = <0x3e 0x3 0x0>;
		status = "okay";
	};

	wireless-bluetooth {
		compatible = "bluetooth-platdata";
		clocks = <0xcd 0x1>;
		clock-names = "ext_clock";
		uart_rts_gpios = <0x42 0x13 0x1>;
		pinctrl-names = "default", "rts_gpio";
		pinctrl-0 = <0xd6>;
		pinctrl-1 = <0xd7>;
		BT,reset_gpio = <0x3e 0x9 0x0>;
		BT,wake_gpio = <0x42 0x1a 0x0>;
		BT,wake_host_irq = <0x3e 0x4 0x0>;
		status = "okay";
	};

	reserved-memory {
		#address-cells = <0x2>;
		#size-cells = <0x2>;
		ranges;

		drm-logo@00000000 {
			compatible = "rockchip,drm-logo";
			reg = <0x0 0x0 0x0 0x0>;
			linux,phandle = <0xc1>;
			phandle = <0xc1>;
		};
	};

	cif_isp@ff910000 {
		compatible = "rockchip,rk3399-cif-isp";
		rockchip,grf = <0x15>;
		reg = <0x0 0xff910000 0x0 0x4000 0x0 0xff968000 0x0 0x8000>;
		reg-names = "register", "dsihost-register";
		clocks = <0x8 0xe7 0x8 0xe9 0x8 0x1e1 0x8 0x1e3 0x8 0x6e 0x8 0xa5 0x8 0x89 0x8 0x89 0x8 0x77>;
		clock-names = "aclk_isp0_noc", "aclk_isp0_wrapper", "hclk_isp0_noc", "hclk_isp0_wrapper", "clk_isp0", "pclk_dphyrx", "clk_cif_out", "clk_cif_pll", "pclk_dphy_ref";
		interrupts = <0x0 0x2b 0x4 0x0>;
		interrupt-names = "cif_isp10_irq";
		power-domains = <0x16 0x13>;
		rockchip,isp,iommu-enable = <0x1>;
		iommus = <0xd8>;
		status = "okay";
		rockchip,camera-modules-attached = <0xd9>;
	};

	cif_isp@ff920000 {
		compatible = "rockchip,rk3399-cif-isp";
		rockchip,grf = <0x15>;
		reg = <0x0 0xff920000 0x0 0x4000 0x0 0xff968000 0x0 0x8000>;
		reg-names = "register", "dsihost-register";
		clocks = <0x8 0xe8 0x8 0xea 0x8 0x1e2 0x8 0x1e4 0x8 0x6f 0x8 0x17b 0x8 0xa4 0x8 0x171 0x8 0x78 0x8 0x89 0x8 0x89 0x8 0x77>;
		clock-names = "aclk_isp1_noc", "aclk_isp1_wrapper", "hclk_isp1_noc", "hclk_isp1_wrapper", "clk_isp1", "pclkin_isp1", "pclk_dphytxrx", "pclk_mipi_dsi", "mipi_dphy_cfg", "clk_cif_out", "clk_cif_pll", "pclk_dphy_ref";
		interrupts = <0x0 0x2c 0x4 0x0>;
		interrupt-names = "cif_isp10_irq";
		power-domains = <0x16 0x14>;
		rockchip,isp,iommu-enable = <0x1>;
		iommus = <0xda>;
		status = "disable";
		rockchip,camera-modules-attached = <0xdb>;
	};

	fiq-debugger {
		compatible = "rockchip,fiq-debugger";
		rockchip,serial-id = <0x2>;
		rockchip,signal-irq = <0xb6>;
		rockchip,wake-irq = <0x0>;
		rockchip,irq-mode-enable = <0x1>;
		rockchip,baudrate = <0x16e360>;
		pinctrl-names = "default";
		pinctrl-0 = <0x4c>;
	};

	edp-panel {
		status = "disabled";
		compatible = "lg,lp079qx1-sp0v", "panel-simple";
		backlight = <0xb7>;
		power-supply = <0xdc>;
		enable-gpios = <0x3f 0x1e 0x0>;
		pinctrl-names = "default";
		pinctrl-0 = <0xdd>;

		ports {

			endpoint {
				remote-endpoint = <0xde>;
				linux,phandle = <0xbe>;
				phandle = <0xbe>;
			};
		};
	};

	hall-mh248 {
		compatible = "hall-mh248";
		pinctrl-names = "default";
		pinctrl-0 = <0xdf>;
		irq-gpio = <0x3e 0xd 0x3>;
		hall-active = <0x1>;
		status = "okay";
	};

	hdmi-codec {
		compatible = "simple-audio-card";
		simple-audio-card,format = "i2s";
		simple-audio-card,mclk-fs = <0x100>;
		simple-audio-card,name = "HDMI-CODEC";

		simple-audio-card,cpu {
			sound-dai = <0xcb>;
		};

		simple-audio-card,codec {
			sound-dai = <0xcc>;
		};
	};

	gpio-keys {
		compatible = "gpio-keys";
		#address-cells = <0x1>;
		#size-cells = <0x0>;
		autorepeat;
		pinctrl-names = "default";
		pinctrl-0 = <0xe0>;

		button@0 {
			gpios = <0x3e 0x5 0x1>;
			linux,code = <0x74>;
			label = "GPIO Key Power";
			linux,input-type = <0x1>;
			gpio-key,wakeup = <0x1>;
			debounce-interval = <0x64>;
		};
	};

	vccadc-ref {
		compatible = "regulator-fixed";
		regulator-name = "vcc1v8_sys";
		regulator-always-on;
		regulator-boot-on;
		regulator-min-microvolt = <0x1b7740>;
		regulator-max-microvolt = <0x1b7740>;
		linux,phandle = <0x31>;
		phandle = <0x31>;
	};

	vcc3v3-pcie-regulator {
		compatible = "regulator-fixed";
		enable-active-high;
		regulator-always-on;
		regulator-boot-on;
		gpio = <0x3e 0x2 0x0>;
		pinctrl-names = "default";
		pinctrl-0 = <0xe1>;
		regulator-name = "vcc3v3_pcie";
	};

	adc-keys {
		compatible = "adc-keys";
		io-channels = <0xe2 0x1>;
		io-channel-names = "buttons";
		poll-interval = <0x64>;
		keyup-threshold-microvolt = <0x1b7740>;

		button-up {
			label = "Volume Up";
			linux,code = <0x73>;
			press-threshold-microvolt = <0x186a0>;
		};

		button-down {
			label = "Volume Down";
			linux,code = <0x72>;
			press-threshold-microvolt = <0x493e0>;
		};

		back {
			label = "Back";
			linux,code = <0x9e>;
			press-threshold-microvolt = <0xf07a8>;
		};

		menu {
			label = "Menu";
			linux,code = <0x8b>;
			press-threshold-microvolt = <0x140cd0>;
		};
	};
};
